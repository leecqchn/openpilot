/******************************************************************************
* ASAP2 file: app.a2l
* Code generation for model "app".
* Model version : 1.172
* Simulink Coder version : 9.4 (R2020b) 29-Jul-2020
* C source code generated on : Thu Feb 24 05:55:06 2022
* Target selection: ert.tlc
* Embedded hardware selection: Infineon->TriCore
* Code generation objectives: Unspecified
* Validation result: Not run
* (add additional file header information here)
******************************************************************************/ ASAP2_VERSION 1 31
/* Version 1.31 */
/begin PROJECT ProjectName "Project Comment Goes Here"
/begin HEADER "Header Comments go here" /end HEADER
/begin MODULE ModuleName "Module Comment Goes Here"
/begin MOD_PAR "MOD PAR Comment Goes Here" /end MOD_PAR
/begin MOD_COMMON "Mod Common Comment Here" BYTE_ORDER MSB_LAST /end MOD_COMMON
/begin RECORD_LAYOUT Scalar_BOOLEAN FNC_VALUES 1 UBYTE COLUMN_DIR DIRECT /end RECORD_LAYOUT
/begin RECORD_LAYOUT Scalar_UBYTE FNC_VALUES 1 UBYTE COLUMN_DIR DIRECT /end RECORD_LAYOUT
/begin RECORD_LAYOUT Scalar_BYTE FNC_VALUES 1 SBYTE COLUMN_DIR DIRECT /end RECORD_LAYOUT
/begin RECORD_LAYOUT Scalar_UWORD FNC_VALUES 1 UWORD COLUMN_DIR DIRECT /end RECORD_LAYOUT
/begin RECORD_LAYOUT Scalar_SWORD FNC_VALUES 1 SWORD COLUMN_DIR DIRECT /end RECORD_LAYOUT
/begin RECORD_LAYOUT Scalar_ULONG FNC_VALUES 1 ULONG COLUMN_DIR DIRECT /end RECORD_LAYOUT
/begin RECORD_LAYOUT Scalar_LONG FNC_VALUES 1 SLONG COLUMN_DIR DIRECT /end RECORD_LAYOUT
/begin RECORD_LAYOUT Scalar_FLOAT32_IEEE FNC_VALUES 1 FLOAT32_IEEE COLUMN_DIR DIRECT /end RECORD_LAYOUT
/begin RECORD_LAYOUT Scalar_FLOAT64_IEEE FNC_VALUES 1 FLOAT64_IEEE COLUMN_DIR DIRECT /end RECORD_LAYOUT
/begin RECORD_LAYOUT Lookup1D_BOOLEAN FNC_VALUES 1 UBYTE COLUMN_DIR DIRECT /end RECORD_LAYOUT
/begin RECORD_LAYOUT Lookup1D_X_BOOLEAN AXIS_PTS_X 1 UBYTE INDEX_INCR DIRECT /end RECORD_LAYOUT
/begin RECORD_LAYOUT Lookup1D_BYTE FNC_VALUES 1 SBYTE COLUMN_DIR DIRECT /end RECORD_LAYOUT
/begin RECORD_LAYOUT Lookup1D_X_BYTE AXIS_PTS_X 1 SBYTE INDEX_INCR DIRECT /end RECORD_LAYOUT
/begin RECORD_LAYOUT Lookup1D_UBYTE FNC_VALUES 1 UBYTE COLUMN_DIR DIRECT /end RECORD_LAYOUT
/begin RECORD_LAYOUT Lookup1D_X_UBYTE AXIS_PTS_X 1 UBYTE INDEX_INCR DIRECT /end RECORD_LAYOUT
/begin RECORD_LAYOUT Lookup1D_UWORD FNC_VALUES 1 UWORD COLUMN_DIR DIRECT /end RECORD_LAYOUT
/begin RECORD_LAYOUT Lookup1D_X_UWORD AXIS_PTS_X 1 UWORD INDEX_INCR DIRECT /end RECORD_LAYOUT
/begin RECORD_LAYOUT Lookup1D_WORD FNC_VALUES 1 SWORD COLUMN_DIR DIRECT /end RECORD_LAYOUT
/begin RECORD_LAYOUT Lookup1D_X_WORD AXIS_PTS_X 1 SWORD INDEX_INCR DIRECT /end RECORD_LAYOUT
/begin RECORD_LAYOUT Lookup1D_ULONG FNC_VALUES 1 ULONG COLUMN_DIR DIRECT /end RECORD_LAYOUT
/begin RECORD_LAYOUT Lookup1D_X_ULONG AXIS_PTS_X 1 ULONG INDEX_INCR DIRECT /end RECORD_LAYOUT
/begin RECORD_LAYOUT Lookup1D_SLONG FNC_VALUES 1 SLONG COLUMN_DIR DIRECT /end RECORD_LAYOUT
/begin RECORD_LAYOUT Lookup1D_X_LONG AXIS_PTS_X 1 SLONG INDEX_INCR DIRECT /end RECORD_LAYOUT
/begin RECORD_LAYOUT Lookup1D_FLOAT32_IEEE FNC_VALUES 1 FLOAT32_IEEE COLUMN_DIR DIRECT /end RECORD_LAYOUT
/begin RECORD_LAYOUT Lookup1D_X_FLOAT32_IEEE AXIS_PTS_X 1 FLOAT32_IEEE INDEX_INCR DIRECT /end RECORD_LAYOUT
/begin RECORD_LAYOUT Lookup1D_FLOAT64_IEEE FNC_VALUES 1 FLOAT64_IEEE COLUMN_DIR DIRECT /end RECORD_LAYOUT
/begin RECORD_LAYOUT Lookup1D_X_FLOAT64_IEEE AXIS_PTS_X 1 FLOAT64_IEEE INDEX_INCR DIRECT /end RECORD_LAYOUT
/begin RECORD_LAYOUT Lookup2D_BOOLEAN FNC_VALUES 1 UBYTE COLUMN_DIR DIRECT /end RECORD_LAYOUT
/begin RECORD_LAYOUT Lookup2D_X_BOOLEAN AXIS_PTS_X 1 UBYTE INDEX_INCR DIRECT /end RECORD_LAYOUT
/begin RECORD_LAYOUT Lookup2D_UBYTE FNC_VALUES 1 UBYTE COLUMN_DIR DIRECT /end RECORD_LAYOUT
/begin RECORD_LAYOUT Lookup2D_X_UBYTE AXIS_PTS_X 1 UBYTE INDEX_INCR DIRECT /end RECORD_LAYOUT
/begin RECORD_LAYOUT Lookup2D_BYTE FNC_VALUES 1 SBYTE COLUMN_DIR DIRECT /end RECORD_LAYOUT
/begin RECORD_LAYOUT Lookup2D_X_BYTE AXIS_PTS_X 1 SBYTE INDEX_INCR DIRECT /end RECORD_LAYOUT
/begin RECORD_LAYOUT Lookup2D_UWORD FNC_VALUES 1 UWORD COLUMN_DIR DIRECT /end RECORD_LAYOUT
/begin RECORD_LAYOUT Lookup2D_X_UWORD AXIS_PTS_X 1 UWORD INDEX_INCR DIRECT /end RECORD_LAYOUT
/begin RECORD_LAYOUT Lookup2D_WORD FNC_VALUES 1 SWORD COLUMN_DIR DIRECT /end RECORD_LAYOUT
/begin RECORD_LAYOUT Lookup2D_X_WORD AXIS_PTS_X 1 SWORD INDEX_INCR DIRECT /end RECORD_LAYOUT
/begin RECORD_LAYOUT Lookup2D_ULONG FNC_VALUES 1 ULONG COLUMN_DIR DIRECT /end RECORD_LAYOUT
/begin RECORD_LAYOUT Lookup2D_X_ULONG AXIS_PTS_X 1 ULONG INDEX_INCR DIRECT /end RECORD_LAYOUT
/begin RECORD_LAYOUT Lookup2D_LONG FNC_VALUES 1 SLONG COLUMN_DIR DIRECT /end RECORD_LAYOUT
/begin RECORD_LAYOUT Lookup2D_X_LONG AXIS_PTS_X 1 SLONG INDEX_INCR DIRECT /end RECORD_LAYOUT
/begin RECORD_LAYOUT Lookup2D_FLOAT32_IEEE FNC_VALUES 1 FLOAT32_IEEE COLUMN_DIR DIRECT /end RECORD_LAYOUT
/begin RECORD_LAYOUT Lookup2D_X_FLOAT32_IEEE AXIS_PTS_X 1 FLOAT32_IEEE INDEX_INCR DIRECT /end RECORD_LAYOUT
/begin RECORD_LAYOUT Lookup2D_FLOAT64_IEEE FNC_VALUES 1 FLOAT64_IEEE COLUMN_DIR DIRECT /end RECORD_LAYOUT
/begin RECORD_LAYOUT Lookup2D_X_FLOAT64_IEEE AXIS_PTS_X 1 FLOAT64_IEEE INDEX_INCR DIRECT /end RECORD_LAYOUT
/begin CHARACTERISTIC P_TY_ACC_V_HMIDISSetSpdCmpCnst_sg "" CURVE 0x0000 /* @ECU_Address@P_TY_ACC_V_HMIDISSetSpdCmpCnst_sg@ */ Lookup1D_FLOAT32_IEEE 0 app_CM_single -3.4E+38 3.4E+38
 /begin AXIS_DESCR COM_AXIS NO_INPUT_QUANTITY app_CM_single 5 -3.4E+38 3.4E+38 AXIS_PTS_REF P_TX_ACC_V_HMIDISSetSpdCmpCnst_sg /end AXIS_DESCR
/end CHARACTERISTIC
/begin AXIS_PTS P_TX_ACC_V_HMIDISSetSpdCmpCnst_sg "" 0x0000 /* @ECU_Address@P_TX_ACC_V_HMIDISSetSpdCmpCnst_sg@ */ NO_INPUT_QUANTITY Lookup1D_X_FLOAT32_IEEE 0 app_CM_single 5 -3.4E+38 3.4E+38 /end AXIS_PTS
/begin CHARACTERISTIC P_TY_ACC_d_HMIDetDistLvl12Cmp_sg "[1.2 1 0.8 0.5 0.2 0]
      [1 0.8 0.6 0.4 0.2 0]" CURVE 0x0000 /* @ECU_Address@P_TY_ACC_d_HMIDetDistLvl12Cmp_sg@ */ Lookup1D_FLOAT32_IEEE 0 app_CM_single_m -3.4E+38 3.4E+38
 /begin AXIS_DESCR COM_AXIS NO_INPUT_QUANTITY app_CM_single_m_s 6 -3.4E+38 3.4E+38 AXIS_PTS_REF P_TX_ACC_v_HMIDetDistLvlCmp_sg /end AXIS_DESCR
/end CHARACTERISTIC
/begin AXIS_PTS P_TX_ACC_v_HMIDetDistLvlCmp_sg "" 0x0000 /* @ECU_Address@P_TX_ACC_v_HMIDetDistLvlCmp_sg@ */ NO_INPUT_QUANTITY Lookup1D_X_FLOAT32_IEEE 0 app_CM_single_m_s 6 -3.4E+38 3.4E+38 /end AXIS_PTS
/begin CHARACTERISTIC P_TY_ACC_d_HMIDetDistLvl23Cmp_sg "[0.5 0.4 0.3 0.2 0.1 0] 
      [0.6 0.5 0.4 0.25 0.1 0] update 0807" CURVE 0x0000 /* @ECU_Address@P_TY_ACC_d_HMIDetDistLvl23Cmp_sg@ */ Lookup1D_FLOAT32_IEEE 0 app_CM_single_m -3.4E+38 3.4E+38
 /begin AXIS_DESCR COM_AXIS NO_INPUT_QUANTITY app_CM_single_m_s 6 -3.4E+38 3.4E+38 AXIS_PTS_REF P_TX_ACC_v_HMIDetDistLvlCmp_sg /end AXIS_DESCR
/end CHARACTERISTIC
/begin CHARACTERISTIC k_TRPLon_TY_t_FTCDsrdDistLv1_sg "" CURVE 0x0000 /* @ECU_Address@k_TRPLon_TY_t_FTCDsrdDistLv1_sg@ */ Lookup1D_FLOAT32_IEEE 0 app_CM_single -3.4E+38 3.4E+38
 /begin AXIS_DESCR COM_AXIS NO_INPUT_QUANTITY app_CM_single 14 -3.4E+38 3.4E+38 AXIS_PTS_REF k_TRPLon_TX_v_FTCDsrdDistBrkPnt_sg /end AXIS_DESCR
/end CHARACTERISTIC
/begin AXIS_PTS k_TRPLon_TX_v_FTCDsrdDistBrkPnt_sg "" 0x0000 /* @ECU_Address@k_TRPLon_TX_v_FTCDsrdDistBrkPnt_sg@ */ NO_INPUT_QUANTITY Lookup1D_X_FLOAT32_IEEE 0 app_CM_single 14 -3.4E+38 3.4E+38 /end AXIS_PTS
/begin CHARACTERISTIC k_TRPLon_TY_t_FTCdDesDistLv1_sg "" CURVE 0x0000 /* @ECU_Address@k_TRPLon_TY_t_FTCdDesDistLv1_sg@ */ Lookup1D_FLOAT32_IEEE 0 app_CM_single -3.4E+38 3.4E+38
 /begin AXIS_DESCR COM_AXIS NO_INPUT_QUANTITY app_CM_single 14 -3.4E+38 3.4E+38 AXIS_PTS_REF k_TRPLon_TX_v_FTCdDesSpdNorm_sg /end AXIS_DESCR
/end CHARACTERISTIC
/begin AXIS_PTS k_TRPLon_TX_v_FTCdDesSpdNorm_sg "" 0x0000 /* @ECU_Address@k_TRPLon_TX_v_FTCdDesSpdNorm_sg@ */ NO_INPUT_QUANTITY Lookup1D_X_FLOAT32_IEEE 0 app_CM_single 14 -3.4E+38 3.4E+38 /end AXIS_PTS
/begin CHARACTERISTIC k_TRPLon_TY_t_FTCDsrdDistLv2_sg "" CURVE 0x0000 /* @ECU_Address@k_TRPLon_TY_t_FTCDsrdDistLv2_sg@ */ Lookup1D_FLOAT32_IEEE 0 app_CM_single -3.4E+38 3.4E+38
 /begin AXIS_DESCR COM_AXIS NO_INPUT_QUANTITY app_CM_single 14 -3.4E+38 3.4E+38 AXIS_PTS_REF k_TRPLon_TX_v_FTCDsrdDistBrkPnt_sg /end AXIS_DESCR
/end CHARACTERISTIC
/begin CHARACTERISTIC k_TRPLon_TY_t_FTCdDesDistLv2_sg "" CURVE 0x0000 /* @ECU_Address@k_TRPLon_TY_t_FTCdDesDistLv2_sg@ */ Lookup1D_FLOAT32_IEEE 0 app_CM_single -3.4E+38 3.4E+38
 /begin AXIS_DESCR COM_AXIS NO_INPUT_QUANTITY app_CM_single 14 -3.4E+38 3.4E+38 AXIS_PTS_REF k_TRPLon_TX_v_FTCdDesSpdNorm_sg /end AXIS_DESCR
/end CHARACTERISTIC
/begin CHARACTERISTIC k_TRPLon_TY_t_FTCDsrdDistLv3_sg "" CURVE 0x0000 /* @ECU_Address@k_TRPLon_TY_t_FTCDsrdDistLv3_sg@ */ Lookup1D_FLOAT32_IEEE 0 app_CM_single -3.4E+38 3.4E+38
 /begin AXIS_DESCR COM_AXIS NO_INPUT_QUANTITY app_CM_single 14 -3.4E+38 3.4E+38 AXIS_PTS_REF k_TRPLon_TX_v_FTCDsrdDistBrkPnt_sg /end AXIS_DESCR
/end CHARACTERISTIC
/begin CHARACTERISTIC k_TRPLon_TY_t_FTCdDesDistLv3_sg "" CURVE 0x0000 /* @ECU_Address@k_TRPLon_TY_t_FTCdDesDistLv3_sg@ */ Lookup1D_FLOAT32_IEEE 0 app_CM_single -3.4E+38 3.4E+38
 /begin AXIS_DESCR COM_AXIS NO_INPUT_QUANTITY app_CM_single 14 -3.4E+38 3.4E+38 AXIS_PTS_REF k_TRPLon_TX_v_FTCdDesSpdNorm_sg /end AXIS_DESCR
/end CHARACTERISTIC
/begin CHARACTERISTIC P_DFIn_cntr_DelayCntr_d "The delay number for the Estimated acceleration filter modular." VALUE 0x0000 /* @ECU_Address@P_DFIn_cntr_DelayCntr_d@ */ Scalar_FLOAT64_IEEE 0 app_CM_double -1.7E+308 1.7E+308 /end CHARACTERISTIC
/begin CHARACTERISTIC P_DFIn_cntr_VIDPEgoSpdAvgFltr_d "" VALUE 0x0000 /* @ECU_Address@P_DFIn_cntr_VIDPEgoSpdAvgFltr_d@ */ Scalar_FLOAT64_IEEE 0 app_CM_double -1.7E+308 1.7E+308 /end CHARACTERISTIC
/begin CHARACTERISTIC ACC_v_VIDPEgoSpdMax_sg "Vehicle Roll Back Judge Threshold Ego Vehicle Speed
      " VALUE 0x0000 /* @ECU_Address@ACC_v_VIDPEgoSpdMax_sg@ */ Scalar_FLOAT32_IEEE 0 app_CM_single_m_s -3.4E+38 3.4E+38 /end CHARACTERISTIC
/begin CHARACTERISTIC ACC_v_VIDPEgoSpdMin_sg "Vehicle Roll Back Judge Threshold Ego Vehicle Speed
      " VALUE 0x0000 /* @ECU_Address@ACC_v_VIDPEgoSpdMin_sg@ */ Scalar_FLOAT32_IEEE 0 app_CM_single_m_s -3.4E+38 3.4E+38 /end CHARACTERISTIC
/begin CHARACTERISTIC C_ACC_Gx_HMIActuSpdToIPKSpd_sg "" VALUE 0x0000 /* @ECU_Address@C_ACC_Gx_HMIActuSpdToIPKSpd_sg@ */ Scalar_FLOAT32_IEEE 0 app_CM_single -3.4E+38 3.4E+38 /end CHARACTERISTIC
/begin CHARACTERISTIC C_ACC_HMIZero_sg "" VALUE 0x0000 /* @ECU_Address@C_ACC_HMIZero_sg@ */ Scalar_FLOAT32_IEEE 0 app_CM_single -3.4E+38 3.4E+38 /end CHARACTERISTIC
/begin CHARACTERISTIC C_ACC_SMR_System_step "" VALUE 0x0000 /* @ECU_Address@C_ACC_SMR_System_step@ */ Scalar_FLOAT32_IEEE 0 app_CM_single -3.4E+38 3.4E+38 /end CHARACTERISTIC
/begin CHARACTERISTIC C_ADS_A_VehAirArea_sg "" VALUE 0x0000 /* @ECU_Address@C_ADS_A_VehAirArea_sg@ */ Scalar_FLOAT32_IEEE 0 app_CM_single -3.4E+38 3.4E+38 /end CHARACTERISTIC
/begin CHARACTERISTIC C_ADS_Gx_ActuSpdToIPKSpd_sg "" VALUE 0x0000 /* @ECU_Address@C_ADS_Gx_ActuSpdToIPKSpd_sg@ */ Scalar_FLOAT32_IEEE 0 app_CM_single -3.4E+38 3.4E+38 /end CHARACTERISTIC
/begin CHARACTERISTIC C_ADS_Gx_AirResistRatio_sg "" VALUE 0x0000 /* @ECU_Address@C_ADS_Gx_AirResistRatio_sg@ */ Scalar_FLOAT32_IEEE 0 app_CM_single -3.4E+38 3.4E+38 /end CHARACTERISTIC
/begin CHARACTERISTIC C_ADS_Gx_VehRollResistCmp_sg "" VALUE 0x0000 /* @ECU_Address@C_ADS_Gx_VehRollResistCmp_sg@ */ Scalar_FLOAT32_IEEE 0 app_CM_single -3.4E+38 3.4E+38 /end CHARACTERISTIC
/begin CHARACTERISTIC C_ADS_M_VehMass_sg "" VALUE 0x0000 /* @ECU_Address@C_ADS_M_VehMass_sg@ */ Scalar_FLOAT32_IEEE 0 app_CM_single -3.4E+38 3.4E+38 /end CHARACTERISTIC
/begin CHARACTERISTIC C_ARB_ro_AirDensity_sg "" VALUE 0x0000 /* @ECU_Address@C_ARB_ro_AirDensity_sg@ */ Scalar_FLOAT32_IEEE 0 app_CM_single -3.4E+38 3.4E+38 /end CHARACTERISTIC
/begin CHARACTERISTIC C_DFIn_t_AccelDelyFilt_sg "Acceleration Calculate Delay Time" VALUE 0x0000 /* @ECU_Address@C_DFIn_t_AccelDelyFilt_sg@ */ Scalar_FLOAT32_IEEE 0 app_CM_single_s -3.4E+38 3.4E+38 /end CHARACTERISTIC
/begin CHARACTERISTIC P_ACC_Gx_HMIDistLvlLgrCmpCoe_sg "" VALUE 0x0000 /* @ECU_Address@P_ACC_Gx_HMIDistLvlLgrCmpCoe_sg@ */ Scalar_FLOAT32_IEEE 0 app_CM_single -3.4E+38 3.4E+38 /end CHARACTERISTIC
/begin CHARACTERISTIC P_ACC_Gx_HMIDistLvlSmlCmpCoe_sg "" VALUE 0x0000 /* @ECU_Address@P_ACC_Gx_HMIDistLvlSmlCmpCoe_sg@ */ Scalar_FLOAT32_IEEE 0 app_CM_single -3.4E+38 3.4E+38 /end CHARACTERISTIC
/begin CHARACTERISTIC P_ACC_Gx_HMIDsrdDistLvl1Mid_sg "" VALUE 0x0000 /* @ECU_Address@P_ACC_Gx_HMIDsrdDistLvl1Mid_sg@ */ Scalar_FLOAT32_IEEE 0 app_CM_single -3.4E+38 3.4E+38 /end CHARACTERISTIC
/begin CHARACTERISTIC P_ACC_Gx_HMIDsrdDistLvl1Ner_sg "" VALUE 0x0000 /* @ECU_Address@P_ACC_Gx_HMIDsrdDistLvl1Ner_sg@ */ Scalar_FLOAT32_IEEE 0 app_CM_single -3.4E+38 3.4E+38 /end CHARACTERISTIC
/begin CHARACTERISTIC P_ACC_V_FirstTmActvSpdThrs_sg "ACC first Active Speed Thurshold" VALUE 0x0000 /* @ECU_Address@P_ACC_V_FirstTmActvSpdThrs_sg@ */ Scalar_FLOAT32_IEEE 0 app_CM_single -3.4E+38 3.4E+38 /end CHARACTERISTIC
/begin CHARACTERISTIC P_ACC_V_HMIMemSpdHiThrs_sg "Memory Speed High Threshold" VALUE 0x0000 /* @ECU_Address@P_ACC_V_HMIMemSpdHiThrs_sg@ */ Scalar_FLOAT32_IEEE 0 app_CM_single -3.4E+38 3.4E+38 /end CHARACTERISTIC
/begin CHARACTERISTIC P_ACC_V_HMIMemSpdLoThrs_sg "Memory Speed Low Threshold" VALUE 0x0000 /* @ECU_Address@P_ACC_V_HMIMemSpdLoThrs_sg@ */ Scalar_FLOAT32_IEEE 0 app_CM_single -3.4E+38 3.4E+38 /end CHARACTERISTIC
/begin CHARACTERISTIC P_ACC_d_HMIDistLvlLgrCmp_sg "" VALUE 0x0000 /* @ECU_Address@P_ACC_d_HMIDistLvlLgrCmp_sg@ */ Scalar_FLOAT32_IEEE 0 app_CM_single_m -3.4E+38 3.4E+38 /end CHARACTERISTIC
/begin CHARACTERISTIC P_ACC_d_HMIDistLvlSmlCmp_sg "" VALUE 0x0000 /* @ECU_Address@P_ACC_d_HMIDistLvlSmlCmp_sg@ */ Scalar_FLOAT32_IEEE 0 app_CM_single_m -3.4E+38 3.4E+38 /end CHARACTERISTIC
/begin CHARACTERISTIC P_ACC_d_HMIObjDetMovObjDist_sg "" VALUE 0x0000 /* @ECU_Address@P_ACC_d_HMIObjDetMovObjDist_sg@ */ Scalar_FLOAT32_IEEE 0 app_CM_single_m -3.4E+38 3.4E+38 /end CHARACTERISTIC
/begin CHARACTERISTIC P_ACC_d_HMIObjDetStnObjDist_sg "" VALUE 0x0000 /* @ECU_Address@P_ACC_d_HMIObjDetStnObjDist_sg@ */ Scalar_FLOAT32_IEEE 0 app_CM_single_m -3.4E+38 3.4E+38 /end CHARACTERISTIC
/begin CHARACTERISTIC P_ACC_perc_HMIGoGasPdlThrs_sg "When the acutal gas pedal position is larger than this value, the driver intention
      is considered as part of Go request." VALUE 0x0000 /* @ECU_Address@P_ACC_perc_HMIGoGasPdlThrs_sg@ */ Scalar_FLOAT32_IEEE 0 app_CM_single__ -3.4E+38 3.4E+38 /end CHARACTERISTIC
/begin CHARACTERISTIC P_ACC_perc_MinAccelPdlPos_sg "The value denotes the minimum value for acceleration gas pedal.
      Only when the gas pedal position is larger than this value, is the gas pedal 
      considered as pressed." VALUE 0x0000 /* @ECU_Address@P_ACC_perc_MinAccelPdlPos_sg@ */ Scalar_FLOAT32_IEEE 0 app_CM_single__ -3.4E+38 3.4E+38 /end CHARACTERISTIC
/begin CHARACTERISTIC P_ACC_perc_SMRAccelPdlOvrrdExit_sg "" VALUE 0x0000 /* @ECU_Address@P_ACC_perc_SMRAccelPdlOvrrdExit_sg@ */ Scalar_FLOAT32_IEEE 0 app_CM_single -3.4E+38 3.4E+38 /end CHARACTERISTIC
/begin CHARACTERISTIC P_ACC_t_AccelPdlOverrideExit_sg "" VALUE 0x0000 /* @ECU_Address@P_ACC_t_AccelPdlOverrideExit_sg@ */ Scalar_FLOAT32_IEEE 0 app_CM_single_s -3.4E+38 3.4E+38 /end CHARACTERISTIC
/begin CHARACTERISTIC P_ACC_t_BrkOnlyTmThrs_sg "Para_the maximum Time threshold and after this the brake only mode will exit;" VALUE 0x0000 /* @ECU_Address@P_ACC_t_BrkOnlyTmThrs_sg@ */ Scalar_FLOAT32_IEEE 0 app_CM_single_s -3.4E+38 3.4E+38 /end CHARACTERISTIC
/begin CHARACTERISTIC P_ACC_t_FTCAutoGoTm_sg "Para_when the time length is larger than the para, the ACC will going into StdStl wait status; during wait status the driver operations are needed when the driver wants to drive off automatically;" VALUE 0x0000 /* @ECU_Address@P_ACC_t_FTCAutoGoTm_sg@ */ Scalar_FLOAT32_IEEE 0 app_CM_single_s -3.4E+38 3.4E+38 /end CHARACTERISTIC
/begin CHARACTERISTIC P_ACC_t_HMIObjDetMovObjTmCfm_sg "" VALUE 0x0000 /* @ECU_Address@P_ACC_t_HMIObjDetMovObjTmCfm_sg@ */ Scalar_FLOAT32_IEEE 0 app_CM_single_s -3.4E+38 3.4E+38 /end CHARACTERISTIC
/begin CHARACTERISTIC P_ACC_t_HMIObjDetStnObjTmCfm_sg "" VALUE 0x0000 /* @ECU_Address@P_ACC_t_HMIObjDetStnObjTmCfm_sg@ */ Scalar_FLOAT32_IEEE 0 app_CM_single_s -3.4E+38 3.4E+38 /end CHARACTERISTIC
/begin CHARACTERISTIC P_ACC_t_OvrrdExitTm_sg "P_time threshold; when larger than the value, the ACC will exit to standby.
      20191119 change from 30 to 900 based on CRD1.8" VALUE 0x0000 /* @ECU_Address@P_ACC_t_OvrrdExitTm_sg@ */ Scalar_FLOAT32_IEEE 0 app_CM_single_s -3.4E+38 3.4E+38 /end CHARACTERISTIC
/begin CHARACTERISTIC P_ACC_v_HMIMaxCrsSpdThrsLatActv_sg "Set speed High Threshold" VALUE 0x0000 /* @ECU_Address@P_ACC_v_HMIMaxCrsSpdThrsLatActv_sg@ */ Scalar_FLOAT32_IEEE 0 app_CM_single_m_s -3.4E+38 3.4E+38 /end CHARACTERISTIC
/begin CHARACTERISTIC P_ACC_v_HMIMaxCrsSpdThrs_sg "The Maximum allowed Set Speed. When driver drives vehicle with a speed higher
      thanthis value, and then press the Set Button, the speed will be set as this parameter value.
      20191022 Change the value from 40 to 41.67,to match 150kph ACC Exit" VALUE 0x0000 /* @ECU_Address@P_ACC_v_HMIMaxCrsSpdThrs_sg@ */ Scalar_FLOAT32_IEEE 0 app_CM_single -3.4E+38 3.4E+38 /end CHARACTERISTIC
/begin CHARACTERISTIC P_ACC_v_HMIObjDetMovObjSpd_sg "" VALUE 0x0000 /* @ECU_Address@P_ACC_v_HMIObjDetMovObjSpd_sg@ */ Scalar_FLOAT32_IEEE 0 app_CM_single_m_s -3.4E+38 3.4E+38 /end CHARACTERISTIC
/begin CHARACTERISTIC P_ACC_v_HMIObjDetStnObjSpd_sg "" VALUE 0x0000 /* @ECU_Address@P_ACC_v_HMIObjDetStnObjSpd_sg@ */ Scalar_FLOAT32_IEEE 0 app_CM_single_m_s -3.4E+38 3.4E+38 /end CHARACTERISTIC
/begin CHARACTERISTIC P_ACC_v_HMISetSpdHiThrs_sg "Set speed High Threshold" VALUE 0x0000 /* @ECU_Address@P_ACC_v_HMISetSpdHiThrs_sg@ */ Scalar_FLOAT32_IEEE 0 app_CM_single_m_s -3.4E+38 3.4E+38 /end CHARACTERISTIC
/begin CHARACTERISTIC P_ACC_v_HMISetSpdLoThrs_sg "Set speed Low Threshold" VALUE 0x0000 /* @ECU_Address@P_ACC_v_HMISetSpdLoThrs_sg@ */ Scalar_FLOAT32_IEEE 0 app_CM_single_m_s -3.4E+38 3.4E+38 /end CHARACTERISTIC
/begin CHARACTERISTIC P_ACC_v_SMRMaxCrsSpdThrs_sg "" VALUE 0x0000 /* @ECU_Address@P_ACC_v_SMRMaxCrsSpdThrs_sg@ */ Scalar_FLOAT32_IEEE 0 app_CM_single -3.4E+38 3.4E+38 /end CHARACTERISTIC
/begin CHARACTERISTIC P_DFIn_a_EstdLogAccTrtLoThrs_sg "m/s2, Estimated Longitudinal Acceleration Trust Value Low Threshold
      if < the value, use the Acceleration from sensor" VALUE 0x0000 /* @ECU_Address@P_DFIn_a_EstdLogAccTrtLoThrs_sg@ */ Scalar_FLOAT32_IEEE 0 app_CM_single -3.4E+38 3.4E+38 /end CHARACTERISTIC
/begin CHARACTERISTIC P_DFIn_perc_AclActuPosOvrdHi_sg "" VALUE 0x0000 /* @ECU_Address@P_DFIn_perc_AclActuPosOvrdHi_sg@ */ Scalar_FLOAT32_IEEE 0 app_CM_single__ -3.4E+38 3.4E+38 /end CHARACTERISTIC
/begin CHARACTERISTIC P_DFIn_perc_AclActuPosOvrdLo_sg "" VALUE 0x0000 /* @ECU_Address@P_DFIn_perc_AclActuPosOvrdLo_sg@ */ Scalar_FLOAT32_IEEE 0 app_CM_single__ -3.4E+38 3.4E+38 /end CHARACTERISTIC
/begin CHARACTERISTIC P_DFIn_t_ABSActv_sg "/*When the signal satisfies the entry condition, a counter-func will be triggered. 
      E.g. It may be more proper to trust the ABS_Active=1 only if the counter about  ABS_Active=1 is larger than 15, 
      and the time length is 15*t_sample.*/" VALUE 0x0000 /* @ECU_Address@P_DFIn_t_ABSActv_sg@ */ Scalar_FLOAT32_IEEE 0 app_CM_single_s -3.4E+38 3.4E+38 /end CHARACTERISTIC
/begin CHARACTERISTIC P_DFIn_t_ACCSpdDecHldCmdFrq_sg "20191121 based on CRD1.8" VALUE 0x0000 /* @ECU_Address@P_DFIn_t_ACCSpdDecHldCmdFrq_sg@ */ Scalar_FLOAT32_IEEE 0 app_CM_single_s -3.4E+38 3.4E+38 /end CHARACTERISTIC
/begin CHARACTERISTIC P_DFIn_t_ACCSpdDecHldThrs_sg "20191121 based on CRD1.8 changed to 0.2 - by Chencong
     20191202 based on CRD1.9 changed to 0.5 - by WANGBIN
     " VALUE 0x0000 /* @ECU_Address@P_DFIn_t_ACCSpdDecHldThrs_sg@ */ Scalar_FLOAT32_IEEE 0 app_CM_single_s -3.4E+38 3.4E+38 /end CHARACTERISTIC
/begin CHARACTERISTIC P_DFIn_t_ACCSpdIncHldCmdFrq_sg "20191121 based on CRD1.8" VALUE 0x0000 /* @ECU_Address@P_DFIn_t_ACCSpdIncHldCmdFrq_sg@ */ Scalar_FLOAT32_IEEE 0 app_CM_single_s -3.4E+38 3.4E+38 /end CHARACTERISTIC
/begin CHARACTERISTIC P_DFIn_t_ACCSpdIncHldThrs_sg "20191121 based on CRD1.8 changed to 0.2 - by Chencong
     20191202 based on CRD1.9 changed to 0.5 - by WANGBIN
     " VALUE 0x0000 /* @ECU_Address@P_DFIn_t_ACCSpdIncHldThrs_sg@ */ Scalar_FLOAT32_IEEE 0 app_CM_single_s -3.4E+38 3.4E+38 /end CHARACTERISTIC
/begin CHARACTERISTIC P_DFIn_t_ACCToqReqRespNoReqHys_sg "ACC_DP Parameter
     ECM Responce time hysteresis" VALUE 0x0000 /* @ECU_Address@P_DFIn_t_ACCToqReqRespNoReqHys_sg@ */ Scalar_FLOAT32_IEEE 0 app_CM_single -3.4E+38 3.4E+38 /end CHARACTERISTIC
/begin CHARACTERISTIC P_DFIn_t_CCFMAEBActvEver_sg "" VALUE 0x0000 /* @ECU_Address@P_DFIn_t_CCFMAEBActvEver_sg@ */ Scalar_FLOAT32_IEEE 0 app_CM_single -3.4E+38 3.4E+38 /end CHARACTERISTIC
/begin CHARACTERISTIC P_DFIn_t_ChACCAccReqRespLosArb_sg "" VALUE 0x0000 /* @ECU_Address@P_DFIn_t_ChACCAccReqRespLosArb_sg@ */ Scalar_FLOAT32_IEEE 0 app_CM_single_s -3.4E+38 3.4E+38 /end CHARACTERISTIC
/begin CHARACTERISTIC P_DFIn_t_ChACCAccReqRespNoReqHys_sg "ACC_DP Parameter
     ESP Responce time hysteresis" VALUE 0x0000 /* @ECU_Address@P_DFIn_t_ChACCAccReqRespNoReqHys_sg@ */ Scalar_FLOAT32_IEEE 0 app_CM_single -3.4E+38 3.4E+38 /end CHARACTERISTIC
/begin CHARACTERISTIC P_DFIn_t_DrvrSbltAtcHys_sg "" VALUE 0x0000 /* @ECU_Address@P_DFIn_t_DrvrSbltAtcHys_sg@ */ Scalar_FLOAT32_IEEE 0 app_CM_single_s -3.4E+38 3.4E+38 /end CHARACTERISTIC
/begin CHARACTERISTIC P_DFIn_t_ESPActv_sg "" VALUE 0x0000 /* @ECU_Address@P_DFIn_t_ESPActv_sg@ */ Scalar_FLOAT32_IEEE 0 app_CM_single_s -3.4E+38 3.4E+38 /end CHARACTERISTIC
/begin CHARACTERISTIC P_DFIn_t_HDCActv_sg "CALI PARA.
     HDC aborton time threshold, when HDC active time length is larger than this para, the system
     will not support ACC and TJA." VALUE 0x0000 /* @ECU_Address@P_DFIn_t_HDCActv_sg@ */ Scalar_FLOAT32_IEEE 0 app_CM_single_s -3.4E+38 3.4E+38 /end CHARACTERISTIC
/begin CHARACTERISTIC P_DFIn_t_TCSActv_sg "" VALUE 0x0000 /* @ECU_Address@P_DFIn_t_TCSActv_sg@ */ Scalar_FLOAT32_IEEE 0 app_CM_single_s -3.4E+38 3.4E+38 /end CHARACTERISTIC
/begin CHARACTERISTIC P_DFIn_t_VSELongtAccelFilter_sg "VSE Longitudinal Acceleration Confirming Time Threshold" VALUE 0x0000 /* @ECU_Address@P_DFIn_t_VSELongtAccelFilter_sg@ */ Scalar_FLOAT32_IEEE 0 app_CM_single_s -3.4E+38 3.4E+38 /end CHARACTERISTIC
/begin CHARACTERISTIC P_DFIn_v_RolBckVehSpdThrs_sg "Vehicle Roll Back Judge Threshold Ego Vehicle Speed
     " VALUE 0x0000 /* @ECU_Address@P_DFIn_v_RolBckVehSpdThrs_sg@ */ Scalar_FLOAT32_IEEE 0 app_CM_single_m_s -3.4E+38 3.4E+38 /end CHARACTERISTIC
/begin CHARACTERISTIC k_TRPLon_Gx_DesireDistHiSpd_sg "" VALUE 0x0000 /* @ECU_Address@k_TRPLon_Gx_DesireDistHiSpd_sg@ */ Scalar_FLOAT32_IEEE 0 app_CM_single -3.4E+38 3.4E+38 /end CHARACTERISTIC
/begin CHARACTERISTIC k_TRPLon_Gx_DesireDistLowSpd_sg "" VALUE 0x0000 /* @ECU_Address@k_TRPLon_Gx_DesireDistLowSpd_sg@ */ Scalar_FLOAT32_IEEE 0 app_CM_single -3.4E+38 3.4E+38 /end CHARACTERISTIC
/begin CHARACTERISTIC k_TRPLon_Gx_PrdctTime_sg "" VALUE 0x0000 /* @ECU_Address@k_TRPLon_Gx_PrdctTime_sg@ */ Scalar_FLOAT32_IEEE 0 app_CM_single -3.4E+38 3.4E+38 /end CHARACTERISTIC
/begin CHARACTERISTIC k_TRPLon_Gx_TrajKtWght_sg "" VALUE 0x0000 /* @ECU_Address@k_TRPLon_Gx_TrajKtWght_sg@ */ Scalar_FLOAT32_IEEE 0 app_CM_single -3.4E+38 3.4E+38 /end CHARACTERISTIC
/begin CHARACTERISTIC k_TRPLon_Gx_aStateGain_sg "" VALUE 0x0000 /* @ECU_Address@k_TRPLon_Gx_aStateGain_sg@ */ Scalar_FLOAT32_IEEE 0 app_CM_single -3.4E+38 3.4E+38 /end CHARACTERISTIC
/begin CHARACTERISTIC k_TRPLon_a_ComfortBrake_sg "" VALUE 0x0000 /* @ECU_Address@k_TRPLon_a_ComfortBrake_sg@ */ Scalar_FLOAT32_IEEE 0 app_CM_single -3.4E+38 3.4E+38 /end CHARACTERISTIC
/begin CHARACTERISTIC k_TRPLon_cof_Kt_TblData_sg "" VAL_BLK 0x0000 /* @ECU_Address@k_TRPLon_cof_Kt_TblData_sg@ */ Scalar_FLOAT32_IEEE 0 app_CM_single -3.4E+38 3.4E+38 NUMBER 11 /end CHARACTERISTIC
/begin CHARACTERISTIC k_TRPLon_cof_TrajJerkWght_sg "" VALUE 0x0000 /* @ECU_Address@k_TRPLon_cof_TrajJerkWght_sg@ */ Scalar_FLOAT32_IEEE 0 app_CM_single -3.4E+38 3.4E+38 /end CHARACTERISTIC
/begin CHARACTERISTIC k_TRPLon_cof_TrajLimVlatnWght_sg "" VALUE 0x0000 /* @ECU_Address@k_TRPLon_cof_TrajLimVlatnWght_sg@ */ Scalar_FLOAT32_IEEE 0 app_CM_single -3.4E+38 3.4E+38 /end CHARACTERISTIC
/begin CHARACTERISTIC k_TRPLon_d_DistMinGapFar_sg "" VALUE 0x0000 /* @ECU_Address@k_TRPLon_d_DistMinGapFar_sg@ */ Scalar_FLOAT32_IEEE 0 app_CM_single_m -3.4E+38 3.4E+38 /end CHARACTERISTIC
/begin CHARACTERISTIC k_TRPLon_d_DistMinGapMid_sg "" VALUE 0x0000 /* @ECU_Address@k_TRPLon_d_DistMinGapMid_sg@ */ Scalar_FLOAT32_IEEE 0 app_CM_single_m -3.4E+38 3.4E+38 /end CHARACTERISTIC
/begin CHARACTERISTIC k_TRPLon_d_DistMinGapNear_sg "changed to 2,8 from2.6m" VALUE 0x0000 /* @ECU_Address@k_TRPLon_d_DistMinGapNear_sg@ */ Scalar_FLOAT32_IEEE 0 app_CM_single_m -3.4E+38 3.4E+38 /end CHARACTERISTIC
/begin CHARACTERISTIC k_TRPLon_t_DistNrmRePlanTm_sg "" VALUE 0x0000 /* @ECU_Address@k_TRPLon_t_DistNrmRePlanTm_sg@ */ Scalar_FLOAT32_IEEE 0 app_CM_single -3.4E+38 3.4E+38 /end CHARACTERISTIC
/begin CHARACTERISTIC k_TRPLon_t_RelDistPrdctTmVx_sg "" VALUE 0x0000 /* @ECU_Address@k_TRPLon_t_RelDistPrdctTmVx_sg@ */ Scalar_FLOAT32_IEEE 0 app_CM_single -3.4E+38 3.4E+38 /end CHARACTERISTIC
/begin CHARACTERISTIC k_TRP_t_NrmRplnTm_sg "" VALUE 0x0000 /* @ECU_Address@k_TRP_t_NrmRplnTm_sg@ */ Scalar_FLOAT32_IEEE 0 app_CM_single -3.4E+38 3.4E+38 /end CHARACTERISTIC
/begin CHARACTERISTIC P_ACC_cntr_HMISETBtnDecFunc_u16 "" VALUE 0x0000 /* @ECU_Address@P_ACC_cntr_HMISETBtnDecFunc_u16@ */ Scalar_UWORD 0 app_CM_uint16 0 65535 /end CHARACTERISTIC
/begin CHARACTERISTIC P_DFIn_n_EngRunActvMaxSpd_u16 "The value indicates a speed value when the engine is in fault mode." VALUE 0x0000 /* @ECU_Address@P_DFIn_n_EngRunActvMaxSpd_u16@ */ Scalar_UWORD 0 app_CM_uint16 0 65535 /end CHARACTERISTIC
/begin CHARACTERISTIC P_DFIn_n_EngRunActvSpd_u16 "/* Tunable Parameter. 
     It shall be lower than engine idle speed for every project. */ " VALUE 0x0000 /* @ECU_Address@P_DFIn_n_EngRunActvSpd_u16@ */ Scalar_UWORD 0 app_CM_uint16 0 65535 /end CHARACTERISTIC
/begin CHARACTERISTIC C_ACC_HMISwitch_Off_bl "" VALUE 0x0000 /* @ECU_Address@C_ACC_HMISwitch_Off_bl@ */ Scalar_BOOLEAN 0 app_CM_boolean 0 1 /end CHARACTERISTIC
/begin CHARACTERISTIC C_ACC_HMISwitch_On_bl "" VALUE 0x0000 /* @ECU_Address@C_ACC_HMISwitch_On_bl@ */ Scalar_BOOLEAN 0 app_CM_boolean 0 1 /end CHARACTERISTIC
/begin CHARACTERISTIC C_ACC_HMIZero_bl "" VALUE 0x0000 /* @ECU_Address@C_ACC_HMIZero_bl@ */ Scalar_BOOLEAN 0 app_CM_boolean 0 1 /end CHARACTERISTIC
/begin CHARACTERISTIC P_ACC_is_CCFM_ABSActvEnIN_bl "" VALUE 0x0000 /* @ECU_Address@P_ACC_is_CCFM_ABSActvEnIN_bl@ */ Scalar_BOOLEAN 0 app_CM_boolean 0 1 /end CHARACTERISTIC
/begin CHARACTERISTIC P_ACC_is_CCFM_ABSActvIN_bl "" VALUE 0x0000 /* @ECU_Address@P_ACC_is_CCFM_ABSActvIN_bl@ */ Scalar_BOOLEAN 0 app_CM_boolean 0 1 /end CHARACTERISTIC
/begin CHARACTERISTIC P_ACC_is_CCFM_ACCCanclIN_bl "" VALUE 0x0000 /* @ECU_Address@P_ACC_is_CCFM_ACCCanclIN_bl@ */ Scalar_BOOLEAN 0 app_CM_boolean 0 1 /end CHARACTERISTIC
/begin CHARACTERISTIC P_ACC_is_CCFM_ACCReqFltIN_bl "" VALUE 0x0000 /* @ECU_Address@P_ACC_is_CCFM_ACCReqFltIN_bl@ */ Scalar_BOOLEAN 0 app_CM_boolean 0 1 /end CHARACTERISTIC
/begin CHARACTERISTIC P_ACC_is_CCFM_ACCReqIN_bl "" VALUE 0x0000 /* @ECU_Address@P_ACC_is_CCFM_ACCReqIN_bl@ */ Scalar_BOOLEAN 0 app_CM_boolean 0 1 /end CHARACTERISTIC
/begin CHARACTERISTIC P_ACC_is_CCFM_ACCTgtLosIN_bl "" VALUE 0x0000 /* @ECU_Address@P_ACC_is_CCFM_ACCTgtLosIN_bl@ */ Scalar_BOOLEAN 0 app_CM_boolean 0 1 /end CHARACTERISTIC
/begin CHARACTERISTIC P_ACC_is_CCFM_AEBPActvIN_bl "" VALUE 0x0000 /* @ECU_Address@P_ACC_is_CCFM_AEBPActvIN_bl@ */ Scalar_BOOLEAN 0 app_CM_boolean 0 1 /end CHARACTERISTIC
/begin CHARACTERISTIC P_ACC_is_CCFM_AEBVActvExitIN_bl "" VALUE 0x0000 /* @ECU_Address@P_ACC_is_CCFM_AEBVActvExitIN_bl@ */ Scalar_BOOLEAN 0 app_CM_boolean 0 1 /end CHARACTERISTIC
/begin CHARACTERISTIC P_ACC_is_CCFM_AEBVActvIN_bl "" VALUE 0x0000 /* @ECU_Address@P_ACC_is_CCFM_AEBVActvIN_bl@ */ Scalar_BOOLEAN 0 app_CM_boolean 0 1 /end CHARACTERISTIC
/begin CHARACTERISTIC P_ACC_is_CCFM_APAActvIN_bl "" VALUE 0x0000 /* @ECU_Address@P_ACC_is_CCFM_APAActvIN_bl@ */ Scalar_BOOLEAN 0 app_CM_boolean 0 1 /end CHARACTERISTIC
/begin CHARACTERISTIC P_ACC_is_CCFM_AccRepLArbEnIN_bl "" VALUE 0x0000 /* @ECU_Address@P_ACC_is_CCFM_AccRepLArbEnIN_bl@ */ Scalar_BOOLEAN 0 app_CM_boolean 0 1 /end CHARACTERISTIC
/begin CHARACTERISTIC P_ACC_is_CCFM_AccRepPCndEnIN_bl "" VALUE 0x0000 /* @ECU_Address@P_ACC_is_CCFM_AccRepPCndEnIN_bl@ */ Scalar_BOOLEAN 0 app_CM_boolean 0 1 /end CHARACTERISTIC
/begin CHARACTERISTIC P_ACC_is_CCFM_AccRespErrIN_bl "" VALUE 0x0000 /* @ECU_Address@P_ACC_is_CCFM_AccRespErrIN_bl@ */ Scalar_BOOLEAN 0 app_CM_boolean 0 1 /end CHARACTERISTIC
/begin CHARACTERISTIC P_ACC_is_CCFM_AccRespLArbIN_bl "" VALUE 0x0000 /* @ECU_Address@P_ACC_is_CCFM_AccRespLArbIN_bl@ */ Scalar_BOOLEAN 0 app_CM_boolean 0 1 /end CHARACTERISTIC
/begin CHARACTERISTIC P_ACC_is_CCFM_AccRespNReqIN_bl "" VALUE 0x0000 /* @ECU_Address@P_ACC_is_CCFM_AccRespNReqIN_bl@ */ Scalar_BOOLEAN 0 app_CM_boolean 0 1 /end CHARACTERISTIC
/begin CHARACTERISTIC P_ACC_is_CCFM_AccRespPCndIN_bl "" VALUE 0x0000 /* @ECU_Address@P_ACC_is_CCFM_AccRespPCndIN_bl@ */ Scalar_BOOLEAN 0 app_CM_boolean 0 1 /end CHARACTERISTIC
/begin CHARACTERISTIC P_ACC_is_CCFM_AirbagStsIN_bl "" VALUE 0x0000 /* @ECU_Address@P_ACC_is_CCFM_AirbagStsIN_bl@ */ Scalar_BOOLEAN 0 app_CM_boolean 0 1 /end CHARACTERISTIC
/begin CHARACTERISTIC P_ACC_is_CCFM_BntStsIN_bl "" VALUE 0x0000 /* @ECU_Address@P_ACC_is_CCFM_BntStsIN_bl@ */ Scalar_BOOLEAN 0 app_CM_boolean 0 1 /end CHARACTERISTIC
/begin CHARACTERISTIC P_ACC_is_CCFM_BrkDicTemHIN_bl "" VALUE 0x0000 /* @ECU_Address@P_ACC_is_CCFM_BrkDicTemHIN_bl@ */ Scalar_BOOLEAN 0 app_CM_boolean 0 1 /end CHARACTERISTIC
/begin CHARACTERISTIC P_ACC_is_CCFM_BrkPdlBkOyIN_bl "" VALUE 0x0000 /* @ECU_Address@P_ACC_is_CCFM_BrkPdlBkOyIN_bl@ */ Scalar_BOOLEAN 0 app_CM_boolean 0 1 /end CHARACTERISTIC
/begin CHARACTERISTIC P_ACC_is_CCFM_CCSDataIngIN_bl "" VALUE 0x0000 /* @ECU_Address@P_ACC_is_CCFM_CCSDataIngIN_bl@ */ Scalar_BOOLEAN 0 app_CM_boolean 0 1 /end CHARACTERISTIC
/begin CHARACTERISTIC P_ACC_is_CCFM_DrvDoorIN_bl "" VALUE 0x0000 /* @ECU_Address@P_ACC_is_CCFM_DrvDoorIN_bl@ */ Scalar_BOOLEAN 0 app_CM_boolean 0 1 /end CHARACTERISTIC
/begin CHARACTERISTIC P_ACC_is_CCFM_DrvngMdNoSuptIN_bl "" VALUE 0x0000 /* @ECU_Address@P_ACC_is_CCFM_DrvngMdNoSuptIN_bl@ */ Scalar_BOOLEAN 0 app_CM_boolean 0 1 /end CHARACTERISTIC
/begin CHARACTERISTIC P_ACC_is_CCFM_DspdSpdIN_bl "" VALUE 0x0000 /* @ECU_Address@P_ACC_is_CCFM_DspdSpdIN_bl@ */ Scalar_BOOLEAN 0 app_CM_boolean 0 1 /end CHARACTERISTIC
/begin CHARACTERISTIC P_ACC_is_CCFM_EPBAppIN_bl "" VALUE 0x0000 /* @ECU_Address@P_ACC_is_CCFM_EPBAppIN_bl@ */ Scalar_BOOLEAN 0 app_CM_boolean 0 1 /end CHARACTERISTIC
/begin CHARACTERISTIC P_ACC_is_CCFM_EPBCCCanclIN_bl "" VALUE 0x0000 /* @ECU_Address@P_ACC_is_CCFM_EPBCCCanclIN_bl@ */ Scalar_BOOLEAN 0 app_CM_boolean 0 1 /end CHARACTERISTIC
/begin CHARACTERISTIC P_ACC_is_CCFM_EPBStsUnkwIN_bl "" VALUE 0x0000 /* @ECU_Address@P_ACC_is_CCFM_EPBStsUnkwIN_bl@ */ Scalar_BOOLEAN 0 app_CM_boolean 0 1 /end CHARACTERISTIC
/begin CHARACTERISTIC P_ACC_is_CCFM_EmsnRltdIN_bl "" VALUE 0x0000 /* @ECU_Address@P_ACC_is_CCFM_EmsnRltdIN_bl@ */ Scalar_BOOLEAN 0 app_CM_boolean 0 1 /end CHARACTERISTIC
/begin CHARACTERISTIC P_ACC_is_CCFM_EnNoActvIN_bl "" VALUE 0x0000 /* @ECU_Address@P_ACC_is_CCFM_EnNoActvIN_bl@ */ Scalar_BOOLEAN 0 app_CM_boolean 0 1 /end CHARACTERISTIC
/begin CHARACTERISTIC P_ACC_is_CCFM_FVCMBlkIN_bl "" VALUE 0x0000 /* @ECU_Address@P_ACC_is_CCFM_FVCMBlkIN_bl@ */ Scalar_BOOLEAN 0 app_CM_boolean 0 1 /end CHARACTERISTIC
/begin CHARACTERISTIC P_ACC_is_CCFM_FaultBitIhbtIN_bl "" VALUE 0x0000 /* @ECU_Address@P_ACC_is_CCFM_FaultBitIhbtIN_bl@ */ Scalar_BOOLEAN 0 app_CM_boolean 0 1 /end CHARACTERISTIC
/begin CHARACTERISTIC P_ACC_is_CCFM_FrDoorIN_bl "" VALUE 0x0000 /* @ECU_Address@P_ACC_is_CCFM_FrDoorIN_bl@ */ Scalar_BOOLEAN 0 app_CM_boolean 0 1 /end CHARACTERISTIC
/begin CHARACTERISTIC P_ACC_is_CCFM_HDCActvEnIN_bl "" VALUE 0x0000 /* @ECU_Address@P_ACC_is_CCFM_HDCActvEnIN_bl@ */ Scalar_BOOLEAN 0 app_CM_boolean 0 1 /end CHARACTERISTIC
/begin CHARACTERISTIC P_ACC_is_CCFM_HDCActvIN_bl "" VALUE 0x0000 /* @ECU_Address@P_ACC_is_CCFM_HDCActvIN_bl@ */ Scalar_BOOLEAN 0 app_CM_boolean 0 1 /end CHARACTERISTIC
/begin CHARACTERISTIC P_ACC_is_CCFM_ISOCStfdIN_bl "" VALUE 0x0000 /* @ECU_Address@P_ACC_is_CCFM_ISOCStfdIN_bl@ */ Scalar_BOOLEAN 0 app_CM_boolean 0 1 /end CHARACTERISTIC
/begin CHARACTERISTIC P_ACC_is_CCFM_LdSpcStsIN_bl "" VALUE 0x0000 /* @ECU_Address@P_ACC_is_CCFM_LdSpcStsIN_bl@ */ Scalar_BOOLEAN 0 app_CM_boolean 0 1 /end CHARACTERISTIC
/begin CHARACTERISTIC P_ACC_is_CCFM_MSRActvEnIN_bl "" VALUE 0x0000 /* @ECU_Address@P_ACC_is_CCFM_MSRActvEnIN_bl@ */ Scalar_BOOLEAN 0 app_CM_boolean 0 1 /end CHARACTERISTIC
/begin CHARACTERISTIC P_ACC_is_CCFM_MSRActvIN_bl "" VALUE 0x0000 /* @ECU_Address@P_ACC_is_CCFM_MSRActvIN_bl@ */ Scalar_BOOLEAN 0 app_CM_boolean 0 1 /end CHARACTERISTIC
/begin CHARACTERISTIC P_ACC_is_CCFM_NRCDActvIN_bl "" VALUE 0x0000 /* @ECU_Address@P_ACC_is_CCFM_NRCDActvIN_bl@ */ Scalar_BOOLEAN 0 app_CM_boolean 0 1 /end CHARACTERISTIC
/begin CHARACTERISTIC P_ACC_is_CCFM_NonEmsnRltdIN_bl "" VALUE 0x0000 /* @ECU_Address@P_ACC_is_CCFM_NonEmsnRltdIN_bl@ */ Scalar_BOOLEAN 0 app_CM_boolean 0 1 /end CHARACTERISTIC
/begin CHARACTERISTIC P_ACC_is_CCFM_OvrrdReqIN_bl "" VALUE 0x0000 /* @ECU_Address@P_ACC_is_CCFM_OvrrdReqIN_bl@ */ Scalar_BOOLEAN 0 app_CM_boolean 0 1 /end CHARACTERISTIC
/begin CHARACTERISTIC P_ACC_is_CCFM_RLDoorIN_bl "" VALUE 0x0000 /* @ECU_Address@P_ACC_is_CCFM_RLDoorIN_bl@ */ Scalar_BOOLEAN 0 app_CM_boolean 0 1 /end CHARACTERISTIC
/begin CHARACTERISTIC P_ACC_is_CCFM_RRDoorIN_bl "" VALUE 0x0000 /* @ECU_Address@P_ACC_is_CCFM_RRDoorIN_bl@ */ Scalar_BOOLEAN 0 app_CM_boolean 0 1 /end CHARACTERISTIC
/begin CHARACTERISTIC P_ACC_is_CCFM_RolBckIN_bl "" VALUE 0x0000 /* @ECU_Address@P_ACC_is_CCFM_RolBckIN_bl@ */ Scalar_BOOLEAN 0 app_CM_boolean 0 1 /end CHARACTERISTIC
/begin CHARACTERISTIC P_ACC_is_CCFM_SSOCStfdIN_bl "" VALUE 0x0000 /* @ECU_Address@P_ACC_is_CCFM_SSOCStfdIN_bl@ */ Scalar_BOOLEAN 0 app_CM_boolean 0 1 /end CHARACTERISTIC
/begin CHARACTERISTIC P_ACC_is_CCFM_SafyBltStsIN_bl "" VALUE 0x0000 /* @ECU_Address@P_ACC_is_CCFM_SafyBltStsIN_bl@ */ Scalar_BOOLEAN 0 app_CM_boolean 0 1 /end CHARACTERISTIC
/begin CHARACTERISTIC P_ACC_is_CCFM_ShftPosBtIN_bl "" VALUE 0x0000 /* @ECU_Address@P_ACC_is_CCFM_ShftPosBtIN_bl@ */ Scalar_BOOLEAN 0 app_CM_boolean 0 1 /end CHARACTERISTIC
/begin CHARACTERISTIC P_ACC_is_CCFM_ShftPosNeIN_bl "" VALUE 0x0000 /* @ECU_Address@P_ACC_is_CCFM_ShftPosNeIN_bl@ */ Scalar_BOOLEAN 0 app_CM_boolean 0 1 /end CHARACTERISTIC
/begin CHARACTERISTIC P_ACC_is_CCFM_ShftPosPkIN_bl "" VALUE 0x0000 /* @ECU_Address@P_ACC_is_CCFM_ShftPosPkIN_bl@ */ Scalar_BOOLEAN 0 app_CM_boolean 0 1 /end CHARACTERISTIC
/begin CHARACTERISTIC P_ACC_is_CCFM_ShftPosReIN_bl "" VALUE 0x0000 /* @ECU_Address@P_ACC_is_CCFM_ShftPosReIN_bl@ */ Scalar_BOOLEAN 0 app_CM_boolean 0 1 /end CHARACTERISTIC
/begin CHARACTERISTIC P_ACC_is_CCFM_ShftPosUkIN_bl "" VALUE 0x0000 /* @ECU_Address@P_ACC_is_CCFM_ShftPosUkIN_bl@ */ Scalar_BOOLEAN 0 app_CM_boolean 0 1 /end CHARACTERISTIC
/begin CHARACTERISTIC P_ACC_is_CCFM_TCSActvEnIN_bl "" VALUE 0x0000 /* @ECU_Address@P_ACC_is_CCFM_TCSActvEnIN_bl@ */ Scalar_BOOLEAN 0 app_CM_boolean 0 1 /end CHARACTERISTIC
/begin CHARACTERISTIC P_ACC_is_CCFM_TCSActvIN_bl "" VALUE 0x0000 /* @ECU_Address@P_ACC_is_CCFM_TCSActvIN_bl@ */ Scalar_BOOLEAN 0 app_CM_boolean 0 1 /end CHARACTERISTIC
/begin CHARACTERISTIC P_ACC_is_CCFM_TCSOpMdOffIN_bl "" VALUE 0x0000 /* @ECU_Address@P_ACC_is_CCFM_TCSOpMdOffIN_bl@ */ Scalar_BOOLEAN 0 app_CM_boolean 0 1 /end CHARACTERISTIC
/begin CHARACTERISTIC P_ACC_is_CCFM_TCSStsFltIN_bl "" VALUE 0x0000 /* @ECU_Address@P_ACC_is_CCFM_TCSStsFltIN_bl@ */ Scalar_BOOLEAN 0 app_CM_boolean 0 1 /end CHARACTERISTIC
/begin CHARACTERISTIC P_ACC_is_CCFM_ToqRepLArbEnIN_bl "" VALUE 0x0000 /* @ECU_Address@P_ACC_is_CCFM_ToqRepLArbEnIN_bl@ */ Scalar_BOOLEAN 0 app_CM_boolean 0 1 /end CHARACTERISTIC
/begin CHARACTERISTIC P_ACC_is_CCFM_ToqRepPCndEnIN_bl "" VALUE 0x0000 /* @ECU_Address@P_ACC_is_CCFM_ToqRepPCndEnIN_bl@ */ Scalar_BOOLEAN 0 app_CM_boolean 0 1 /end CHARACTERISTIC
/begin CHARACTERISTIC P_ACC_is_CCFM_ToqRespErrIN_bl "" VALUE 0x0000 /* @ECU_Address@P_ACC_is_CCFM_ToqRespErrIN_bl@ */ Scalar_BOOLEAN 0 app_CM_boolean 0 1 /end CHARACTERISTIC
/begin CHARACTERISTIC P_ACC_is_CCFM_ToqRespLArbIN_bl "" VALUE 0x0000 /* @ECU_Address@P_ACC_is_CCFM_ToqRespLArbIN_bl@ */ Scalar_BOOLEAN 0 app_CM_boolean 0 1 /end CHARACTERISTIC
/begin CHARACTERISTIC P_ACC_is_CCFM_ToqRespNReqIN_bl "" VALUE 0x0000 /* @ECU_Address@P_ACC_is_CCFM_ToqRespNReqIN_bl@ */ Scalar_BOOLEAN 0 app_CM_boolean 0 1 /end CHARACTERISTIC
/begin CHARACTERISTIC P_ACC_is_CCFM_ToqRespPCndIN_bl "" VALUE 0x0000 /* @ECU_Address@P_ACC_is_CCFM_ToqRespPCndIN_bl@ */ Scalar_BOOLEAN 0 app_CM_boolean 0 1 /end CHARACTERISTIC
/begin CHARACTERISTIC P_ACC_is_CCFM_TrCCCanclIN_bl "" VALUE 0x0000 /* @ECU_Address@P_ACC_is_CCFM_TrCCCanclIN_bl@ */ Scalar_BOOLEAN 0 app_CM_boolean 0 1 /end CHARACTERISTIC
/begin CHARACTERISTIC P_ACC_is_CCFM_VSEActvEnIN_bl "" VALUE 0x0000 /* @ECU_Address@P_ACC_is_CCFM_VSEActvEnIN_bl@ */ Scalar_BOOLEAN 0 app_CM_boolean 0 1 /end CHARACTERISTIC
/begin CHARACTERISTIC P_ACC_is_CCFM_VSEActvIN_bl "" VALUE 0x0000 /* @ECU_Address@P_ACC_is_CCFM_VSEActvIN_bl@ */ Scalar_BOOLEAN 0 app_CM_boolean 0 1 /end CHARACTERISTIC
/begin CHARACTERISTIC P_ACC_is_CCFM_VSEMdOffIN_bl "" VALUE 0x0000 /* @ECU_Address@P_ACC_is_CCFM_VSEMdOffIN_bl@ */ Scalar_BOOLEAN 0 app_CM_boolean 0 1 /end CHARACTERISTIC
/begin CHARACTERISTIC P_ACC_is_CCFM_VSEStsFltIN_bl "" VALUE 0x0000 /* @ECU_Address@P_ACC_is_CCFM_VSEStsFltIN_bl@ */ Scalar_BOOLEAN 0 app_CM_boolean 0 1 /end CHARACTERISTIC
/begin CHARACTERISTIC P_ACC_is_CCFM_VehSdslIN_bl "" VALUE 0x0000 /* @ECU_Address@P_ACC_is_CCFM_VehSdslIN_bl@ */ Scalar_BOOLEAN 0 app_CM_boolean 0 1 /end CHARACTERISTIC
/begin CHARACTERISTIC P_ACC_is_CCFM_VehSpdOvrIN_bl "" VALUE 0x0000 /* @ECU_Address@P_ACC_is_CCFM_VehSpdOvrIN_bl@ */ Scalar_BOOLEAN 0 app_CM_boolean 0 1 /end CHARACTERISTIC
/begin CHARACTERISTIC P_ACC_is_FullGasPdlExitEnbl_bl "Function configuration parameter 
    Fuction(Full gas pedal Exit) open or not 
    0 close 1 open
    " VALUE 0x0000 /* @ECU_Address@P_ACC_is_FullGasPdlExitEnbl_bl@ */ Scalar_BOOLEAN 0 app_CM_boolean 0 1 /end CHARACTERISTIC
/begin CHARACTERISTIC P_ACC_is_HMIDISMemSpdChgEnBrkO_bl "1 SET Decerese Speed ON
    0 SET Decerese Speed OFF" VALUE 0x0000 /* @ECU_Address@P_ACC_is_HMIDISMemSpdChgEnBrkO_bl@ */ Scalar_BOOLEAN 0 app_CM_boolean 0 1 /end CHARACTERISTIC
/begin CHARACTERISTIC P_ACC_is_HMIDISMemSpdChgEnSdby_bl "1 SET Decerese Speed ON
    0 SET Decerese Speed OFF" VALUE 0x0000 /* @ECU_Address@P_ACC_is_HMIDISMemSpdChgEnSdby_bl@ */ Scalar_BOOLEAN 0 app_CM_boolean 0 1 /end CHARACTERISTIC
/begin CHARACTERISTIC P_ACC_is_HMIDISMemSpdChgEnStslW_bl "1 SET Decerese Speed ON
    0 SET Decerese Speed OFF" VALUE 0x0000 /* @ECU_Address@P_ACC_is_HMIDISMemSpdChgEnStslW_bl@ */ Scalar_BOOLEAN 0 app_CM_boolean 0 1 /end CHARACTERISTIC
/begin CHARACTERISTIC P_ACC_is_HMIDISSetSpdChgEnOvrd_bl "1 SET Decerese Speed ON
    0 SET Decerese Speed OFF" VALUE 0x0000 /* @ECU_Address@P_ACC_is_HMIDISSetSpdChgEnOvrd_bl@ */ Scalar_BOOLEAN 0 app_CM_boolean 0 1 /end CHARACTERISTIC
/begin CHARACTERISTIC P_ACC_is_HMIDISSetSpdChgEnStslA_bl "1 SET Decerese Speed ON
    0 SET Decerese Speed OFF" VALUE 0x0000 /* @ECU_Address@P_ACC_is_HMIDISSetSpdChgEnStslA_bl@ */ Scalar_BOOLEAN 0 app_CM_boolean 0 1 /end CHARACTERISTIC
/begin CHARACTERISTIC P_ACC_is_HMIDISSetSpdSetEnOvrd_bl "1 SET Decerese Speed ON
    0 SET Decerese Speed OFF" VALUE 0x0000 /* @ECU_Address@P_ACC_is_HMIDISSetSpdSetEnOvrd_bl@ */ Scalar_BOOLEAN 0 app_CM_boolean 0 1 /end CHARACTERISTIC
/begin CHARACTERISTIC P_ACC_is_HMIDISSetSpdSetEnStslA_bl "1 SET Decerese Speed ON
    0 SET Decerese Speed OFF" VALUE 0x0000 /* @ECU_Address@P_ACC_is_HMIDISSetSpdSetEnStslA_bl@ */ Scalar_BOOLEAN 0 app_CM_boolean 0 1 /end CHARACTERISTIC
/begin CHARACTERISTIC P_ACC_is_HMIRSMActvFstStdByConfig_bl "0x0  set MemSpd in Standby OFF
    0x1  set MemSpd in Standby ON" VALUE 0x0000 /* @ECU_Address@P_ACC_is_HMIRSMActvFstStdByConfig_bl@ */ Scalar_BOOLEAN 0 app_CM_boolean 0 1 /end CHARACTERISTIC
/begin CHARACTERISTIC P_ACC_is_HMIResumeIncSpdConfig_bl "0x0  Resume speed +1 OFF
    0x1  Resume speed +1 ON" VALUE 0x0000 /* @ECU_Address@P_ACC_is_HMIResumeIncSpdConfig_bl@ */ Scalar_BOOLEAN 0 app_CM_boolean 0 1 /end CHARACTERISTIC
/begin CHARACTERISTIC P_ACC_is_HMISETDecSpdConfig_bl "1 SET Decerese Speed ON
    0 SET Decerese Speed OFF" VALUE 0x0000 /* @ECU_Address@P_ACC_is_HMISETDecSpdConfig_bl@ */ Scalar_BOOLEAN 0 app_CM_boolean 0 1 /end CHARACTERISTIC
/begin CHARACTERISTIC P_ACC_is_HMITJAMaxSpdConfigOpn_bl "1  Open TJA Speed
    0 CLose TJA Speed" VALUE 0x0000 /* @ECU_Address@P_ACC_is_HMITJAMaxSpdConfigOpn_bl@ */ Scalar_BOOLEAN 0 app_CM_boolean 0 1 /end CHARACTERISTIC
/begin CHARACTERISTIC P_ACC_is_SMRTgtLosPrtctWarnOn_bl "" VALUE 0x0000 /* @ECU_Address@P_ACC_is_SMRTgtLosPrtctWarnOn_bl@ */ Scalar_BOOLEAN 0 app_CM_boolean 0 1 /end CHARACTERISTIC
/begin CHARACTERISTIC P_ACC_is_VIDPConfgACCIn_bl "" VALUE 0x0000 /* @ECU_Address@P_ACC_is_VIDPConfgACCIn_bl@ */ Scalar_BOOLEAN 0 app_CM_boolean 0 1 /end CHARACTERISTIC
/begin CHARACTERISTIC P_ACC_is_VIDPIPKSpdUseEstdVal_bl "" VALUE 0x0000 /* @ECU_Address@P_ACC_is_VIDPIPKSpdUseEstdVal_bl@ */ Scalar_BOOLEAN 0 app_CM_boolean 0 1 /end CHARACTERISTIC
/begin CHARACTERISTIC P_ADS_is_EnASSStaConfig_bl "0 Engine
    1 Electric Motor" VALUE 0x0000 /* @ECU_Address@P_ADS_is_EnASSStaConfig_bl@ */ Scalar_BOOLEAN 0 app_CM_boolean 0 1 /end CHARACTERISTIC
/begin CHARACTERISTIC P_ADS_is_EngTypIsMotorConfig_bl "0 Engine
    1 Electric Motor" VALUE 0x0000 /* @ECU_Address@P_ADS_is_EngTypIsMotorConfig_bl@ */ Scalar_BOOLEAN 0 app_CM_boolean 0 1 /end CHARACTERISTIC
/begin CHARACTERISTIC P_DFIn_is_CCFM_BntStsStdstlExit_bl "" VALUE 0x0000 /* @ECU_Address@P_DFIn_is_CCFM_BntStsStdstlExit_bl@ */ Scalar_BOOLEAN 0 app_CM_boolean 0 1 /end CHARACTERISTIC
/begin CHARACTERISTIC P_DFIn_is_CCFM_FrDoorStdstlExit_bl "" VALUE 0x0000 /* @ECU_Address@P_DFIn_is_CCFM_FrDoorStdstlExit_bl@ */ Scalar_BOOLEAN 0 app_CM_boolean 0 1 /end CHARACTERISTIC
/begin CHARACTERISTIC P_DFIn_is_CCFM_LdSpcStsStdstlExit_bl "" VALUE 0x0000 /* @ECU_Address@P_DFIn_is_CCFM_LdSpcStsStdstlExit_bl@ */ Scalar_BOOLEAN 0 app_CM_boolean 0 1 /end CHARACTERISTIC
/begin CHARACTERISTIC P_DFIn_is_CCFM_RLDoorStdstlExit_bl "" VALUE 0x0000 /* @ECU_Address@P_DFIn_is_CCFM_RLDoorStdstlExit_bl@ */ Scalar_BOOLEAN 0 app_CM_boolean 0 1 /end CHARACTERISTIC
/begin CHARACTERISTIC P_DFIn_is_CCFM_RRDoorStdstlExit_bl "" VALUE 0x0000 /* @ECU_Address@P_DFIn_is_CCFM_RRDoorStdstlExit_bl@ */ Scalar_BOOLEAN 0 app_CM_boolean 0 1 /end CHARACTERISTIC
/begin CHARACTERISTIC k_TRPLon_is_FTCBMDsrdDistMdOn_bl "" VALUE 0x0000 /* @ECU_Address@k_TRPLon_is_FTCBMDsrdDistMdOn_bl@ */ Scalar_BOOLEAN 0 app_CM_boolean 0 1 /end CHARACTERISTIC
/begin CHARACTERISTIC k_TRPLon_is_UsePrdctTime_bl "" VALUE 0x0000 /* @ECU_Address@k_TRPLon_is_UsePrdctTime_bl@ */ Scalar_BOOLEAN 0 app_CM_boolean 0 1 /end CHARACTERISTIC
/begin CHARACTERISTIC k_TRPLon_is_Use_dst_target_bl "" VALUE 0x0000 /* @ECU_Address@k_TRPLon_is_Use_dst_target_bl@ */ Scalar_BOOLEAN 0 app_CM_boolean 0 1 /end CHARACTERISTIC
/begin CHARACTERISTIC k_TRPLon_is_UsedDesire0_bl "" VALUE 0x0000 /* @ECU_Address@k_TRPLon_is_UsedDesire0_bl@ */ Scalar_BOOLEAN 0 app_CM_boolean 0 1 /end CHARACTERISTIC
/begin CHARACTERISTIC k_TRPLon_is_UsedDesire1_bl "" VALUE 0x0000 /* @ECU_Address@k_TRPLon_is_UsedDesire1_bl@ */ Scalar_BOOLEAN 0 app_CM_boolean 0 1 /end CHARACTERISTIC
/begin CHARACTERISTIC P_ACC_V_HMIMinCrsSetSpd_u8 "Set Cruise Speed Minimum Value" VALUE 0x0000 /* @ECU_Address@P_ACC_V_HMIMinCrsSetSpd_u8@ */ Scalar_UBYTE 0 app_CM_uint8 0 255 /end CHARACTERISTIC
/begin CHARACTERISTIC P_ACC_V_HMISETBtnDecMax_u8 "Speed difference Threshold
    for Set Button active Decrease Speed function
    " VALUE 0x0000 /* @ECU_Address@P_ACC_V_HMISETBtnDecMax_u8@ */ Scalar_UBYTE 0 app_CM_uint8 0 255 /end CHARACTERISTIC
/begin CHARACTERISTIC P_ACC_V_MaxACCActvSpd_u8 "The maximum cruise speed, Unit Km/h.
    20191022 Change the Parameter name from P_ACC_V_MaxCrsSpd_u8 to P_ACC_V_MaxACCActvSpd_u8
    change the value 150->160(Aptiv CRD1.7)" VALUE 0x0000 /* @ECU_Address@P_ACC_V_MaxACCActvSpd_u8@ */ Scalar_UBYTE 0 app_CM_uint8 0 255 /end CHARACTERISTIC
/begin CHARACTERISTIC P_ACC_V_MinCrsSpd_u8 "The minimum Activation Speed; only if larger than this value,
    can the system be activated.
    " VALUE 0x0000 /* @ECU_Address@P_ACC_V_MinCrsSpd_u8@ */ Scalar_UBYTE 0 app_CM_uint8 0 255 /end CHARACTERISTIC
/begin CHARACTERISTIC P_ACC_indx_HMIDISSpdSwChgRng_u8 "" VALUE 0x0000 /* @ECU_Address@P_ACC_indx_HMIDISSpdSwChgRng_u8@ */ Scalar_UBYTE 0 app_CM_uint8 0 255 /end CHARACTERISTIC
/begin CHARACTERISTIC P_ACC_indx_HMIIniCruzTmDist_u8 "/*Time Distance_1 means 1sec, 2 means 1.5sec and 3 means 2 secs*/
    20191025 change to 3 based on CRD" VALUE 0x0000 /* @ECU_Address@P_ACC_indx_HMIIniCruzTmDist_u8@ */ Scalar_UBYTE 0 app_CM_uint8 0 255 /end CHARACTERISTIC
/begin CHARACTERISTIC P_ACC_v_HMIMinCrsSpdThrs_u8 "The minimum Activation Speed; only if larger than this value,
    can the system be activated." VALUE 0x0000 /* @ECU_Address@P_ACC_v_HMIMinCrsSpdThrs_u8@ */ Scalar_UBYTE 0 app_CM_uint8 0 255 /end CHARACTERISTIC
/begin CHARACTERISTIC P_ACC_v_SMRMinCrsSpdThrs_u8 "" VALUE 0x0000 /* @ECU_Address@P_ACC_v_SMRMinCrsSpdThrs_u8@ */ Scalar_UBYTE 0 app_CM_uint8 0 255 /end CHARACTERISTIC
/begin MEASUREMENT longt_out_drvrSetIPKSpdV "" FLOAT32_IEEE app_CM_single 0 0 -3.4E+38 3.4E+38 ECU_ADDRESS 0x0000 /* @ECU_Address@longt_out_drvrSetIPKSpdV@ */ /end MEASUREMENT
/begin MEASUREMENT m_VehCP_T_ChLKARespToq_sg "" FLOAT32_IEEE app_CM_single 0 0 -3.4E+38 3.4E+38 ECU_ADDRESS 0x0000 /* @ECU_Address@m_VehCP_T_ChLKARespToq_sg@ */ /end MEASUREMENT
/begin MEASUREMENT m_VehCP_T_DrvrStrgDlvrdToq_sg "" FLOAT32_IEEE app_CM_single 0 0 -3.4E+38 3.4E+38 ECU_ADDRESS 0x0000 /* @ECU_Address@m_VehCP_T_DrvrStrgDlvrdToq_sg@ */ /end MEASUREMENT
/begin MEASUREMENT m_VehCP_yr_VehDynYawRate_sg "" FLOAT32_IEEE app_CM_single 0 0 -3.4E+38 3.4E+38 ECU_ADDRESS 0x0000 /* @ECU_Address@m_VehCP_yr_VehDynYawRate_sg@ */ /end MEASUREMENT
/begin MEASUREMENT m_VehCP_angD_StrgWhlAng_sg "" FLOAT32_IEEE app_CM_single 0 0 -3.4E+38 3.4E+38 ECU_ADDRESS 0x0000 /* @ECU_Address@m_VehCP_angD_StrgWhlAng_sg@ */ /end MEASUREMENT
/begin MEASUREMENT m_VehCP_V_VehSpdAvgDrvn_sg "" FLOAT32_IEEE app_CM_single 0 0 -3.4E+38 3.4E+38 ECU_ADDRESS 0x0000 /* @ECU_Address@m_VehCP_V_VehSpdAvgDrvn_sg@ */ /end MEASUREMENT
/begin MEASUREMENT m_VehCP_W_StrgWhlAngGrd_sg "" FLOAT32_IEEE app_CM_single 0 0 -3.4E+38 3.4E+38 ECU_ADDRESS 0x0000 /* @ECU_Address@m_VehCP_W_StrgWhlAngGrd_sg@ */ /end MEASUREMENT
/begin MEASUREMENT longt_out_desAccelCtrlCmd "" FLOAT32_IEEE app_CM_single 0 0 -3.4E+38 3.4E+38 ECU_ADDRESS 0x0000 /* @ECU_Address@longt_out_desAccelCtrlCmd@ */ /end MEASUREMENT
/begin MEASUREMENT YRC_angD_ReqStrgWhlAng_sg "" FLOAT32_IEEE app_CM_single 0 0 -3.4E+38 3.4E+38 ECU_ADDRESS 0x0000 /* @ECU_Address@YRC_angD_ReqStrgWhlAng_sg@ */ /end MEASUREMENT
/begin MEASUREMENT mpc_plan_desCurve "" FLOAT32_IEEE app_CM_single 0 0 -3.4E+38 3.4E+38 ECU_ADDRESS 0x0000 /* @ECU_Address@mpc_plan_desCurve@ */ /end MEASUREMENT
/begin MEASUREMENT m_dst_target "" FLOAT32_IEEE app_CM_single 0 0 -3.4E+38 3.4E+38 ECU_ADDRESS 0x0000 /* @ECU_Address@m_dst_target@ */ /end MEASUREMENT
/begin MEASUREMENT m_dst_red "" FLOAT32_IEEE app_CM_single 0 0 -3.4E+38 3.4E+38 ECU_ADDRESS 0x0000 /* @ECU_Address@m_dst_red@ */ /end MEASUREMENT
/begin MEASUREMENT m_dst_desire "" FLOAT32_IEEE app_CM_single 0 0 -3.4E+38 3.4E+38 ECU_ADDRESS 0x0000 /* @ECU_Address@m_dst_desire@ */ /end MEASUREMENT
/begin MEASUREMENT m_TRP_Replan_Level_Dis "" SLONG app_CM_eRPL_RePlanLevel 0 0 0 4 ECU_ADDRESS 0x0000 /* @ECU_Address@m_TRP_Replan_Level_Dis@ */ /end MEASUREMENT
/begin MEASUREMENT m_TRP_Replan_Level_Spd "" SLONG app_CM_eRPL_RePlanLevel 0 0 0 4 ECU_ADDRESS 0x0000 /* @ECU_Address@m_TRP_Replan_Level_Spd@ */ /end MEASUREMENT
/begin MEASUREMENT m_FSM_sts_ACCSMRSts_en "" SLONG app_CM_E_ACCReqSts_t 0 0 0 15 ECU_ADDRESS 0x0000 /* @ECU_Address@m_FSM_sts_ACCSMRSts_en@ */ /end MEASUREMENT
/begin MEASUREMENT longt_out_drvrSetTmDistLvl "" UBYTE app_CM_uint8 0 0 0 255 ECU_ADDRESS 0x0000 /* @ECU_Address@longt_out_drvrSetTmDistLvl@ */ /end MEASUREMENT
/begin MEASUREMENT m_VehCP_LeftBSD_Warnning_u8 "" UBYTE app_CM_uint8 0 0 0 255 ECU_ADDRESS 0x0000 /* @ECU_Address@m_VehCP_LeftBSD_Warnning_u8@ */ /end MEASUREMENT
/begin MEASUREMENT m_VehCP_RightBSD_Warnning_u8 "" UBYTE app_CM_uint8 0 0 0 255 ECU_ADDRESS 0x0000 /* @ECU_Address@m_VehCP_RightBSD_Warnning_u8@ */ /end MEASUREMENT
/begin MEASUREMENT m_VehCP_n_ChLKACtrlSts_u8 "" UBYTE app_CM_uint8 0 0 0 255 ECU_ADDRESS 0x0000 /* @ECU_Address@m_VehCP_n_ChLKACtrlSts_u8@ */ /end MEASUREMENT
/begin MEASUREMENT m_VehCP_n_StrgCustSetngDspCmd_u8 "" UBYTE app_CM_uint8 0 0 0 255 ECU_ADDRESS 0x0000 /* @ECU_Address@m_VehCP_n_StrgCustSetngDspCmd_u8@ */ /end MEASUREMENT
/begin MEASUREMENT FVCM_EPS_Frame "" UBYTE app_CM_uint8 0 0 0 255 ARRAY_SIZE 8 ECU_ADDRESS 0x0000 /* @ECU_Address@FVCM_EPS_Frame@ */ /end MEASUREMENT
/begin MEASUREMENT FVCM_HMI_Frame "" UBYTE app_CM_uint8 0 0 0 255 ARRAY_SIZE 8 ECU_ADDRESS 0x0000 /* @ECU_Address@FVCM_HMI_Frame@ */ /end MEASUREMENT
/begin MEASUREMENT m_Followed_Traj "" UBYTE app_CM_uint8 0 0 0 255 ECU_ADDRESS 0x0000 /* @ECU_Address@m_Followed_Traj@ */ /end MEASUREMENT
/begin MEASUREMENT long_out_isLeadVehDtct "" UBYTE app_CM_boolean 0 0 0 1 ECU_ADDRESS 0x0000 /* @ECU_Address@long_out_isLeadVehDtct@ */ /end MEASUREMENT
/begin MEASUREMENT m_ACC_is_FSMEnbl01_bl "" UBYTE app_CM_boolean 0 0 0 1 ECU_ADDRESS 0x0000 /* @ECU_Address@m_ACC_is_FSMEnbl01_bl@ */ /end MEASUREMENT
/begin MEASUREMENT m_ACC_is_FSMEnbl02_bl "" UBYTE app_CM_boolean 0 0 0 1 ECU_ADDRESS 0x0000 /* @ECU_Address@m_ACC_is_FSMEnbl02_bl@ */ /end MEASUREMENT
/begin MEASUREMENT m_ACC_is_FSMEnbl03_bl "" UBYTE app_CM_boolean 0 0 0 1 ECU_ADDRESS 0x0000 /* @ECU_Address@m_ACC_is_FSMEnbl03_bl@ */ /end MEASUREMENT
/begin MEASUREMENT m_ACC_is_VehSdslSts_bl "" UBYTE app_CM_boolean 0 0 0 1 ECU_ADDRESS 0x0000 /* @ECU_Address@m_ACC_is_VehSdslSts_bl@ */ /end MEASUREMENT
/begin MEASUREMENT m_ACC_is_SafyBltFstn_bl "" UBYTE app_CM_boolean 0 0 0 1 ECU_ADDRESS 0x0000 /* @ECU_Address@m_ACC_is_SafyBltFstn_bl@ */ /end MEASUREMENT
/begin MEASUREMENT m_ACC_is_FSMEnbl04_bl "" UBYTE app_CM_boolean 0 0 0 1 ECU_ADDRESS 0x0000 /* @ECU_Address@m_ACC_is_FSMEnbl04_bl@ */ /end MEASUREMENT
/begin MEASUREMENT m_ACC_is_FSMEnbl05_bl "" UBYTE app_CM_boolean 0 0 0 1 ECU_ADDRESS 0x0000 /* @ECU_Address@m_ACC_is_FSMEnbl05_bl@ */ /end MEASUREMENT
/begin MEASUREMENT m_ACC_is_FSMEnbl06_bl "" UBYTE app_CM_boolean 0 0 0 1 ECU_ADDRESS 0x0000 /* @ECU_Address@m_ACC_is_FSMEnbl06_bl@ */ /end MEASUREMENT
/begin MEASUREMENT m_ACC_is_FSMEnbl07_bl "" UBYTE app_CM_boolean 0 0 0 1 ECU_ADDRESS 0x0000 /* @ECU_Address@m_ACC_is_FSMEnbl07_bl@ */ /end MEASUREMENT
/begin MEASUREMENT m_ACC_is_ACCFSMEnbl_bl "" UBYTE app_CM_boolean 0 0 0 1 ECU_ADDRESS 0x0000 /* @ECU_Address@m_ACC_is_ACCFSMEnbl_bl@ */ /end MEASUREMENT
/begin MEASUREMENT m_ACC_is_SSMEnbl01_bl "Indicate the left prevention trigger status in ITM.
    " UBYTE app_CM_boolean 0 0 0 1 ECU_ADDRESS 0x0000 /* @ECU_Address@m_ACC_is_SSMEnbl01_bl@ */ /end MEASUREMENT
/begin MEASUREMENT m_ACC_is_ACCSSMEnbl_bl "" UBYTE app_CM_boolean 0 0 0 1 ECU_ADDRESS 0x0000 /* @ECU_Address@m_ACC_is_ACCSSMEnbl_bl@ */ /end MEASUREMENT
/begin MEASUREMENT m_ACC_is_FSMDsbl01_bl "Indicate the left prevention trigger status in ITM.
    " UBYTE app_CM_boolean 0 0 0 1 ECU_ADDRESS 0x0000 /* @ECU_Address@m_ACC_is_FSMDsbl01_bl@ */ /end MEASUREMENT
/begin MEASUREMENT m_ACC_is_ACCActvGeneral_bl "" UBYTE app_CM_boolean 0 0 0 1 ECU_ADDRESS 0x0000 /* @ECU_Address@m_ACC_is_ACCActvGeneral_bl@ */ /end MEASUREMENT
/begin MEASUREMENT m_ACC_is_ACCOvrrdReq_bl "" UBYTE app_CM_boolean 0 0 0 1 ECU_ADDRESS 0x0000 /* @ECU_Address@m_ACC_is_ACCOvrrdReq_bl@ */ /end MEASUREMENT
/begin MEASUREMENT m_ACC_is_FSMDsbl02_bl "Indicate the left prevention trigger status in ITM.
    " UBYTE app_CM_boolean 0 0 0 1 ECU_ADDRESS 0x0000 /* @ECU_Address@m_ACC_is_FSMDsbl02_bl@ */ /end MEASUREMENT
/begin MEASUREMENT m_ACC_is_FSMDsbl03_bl "Indicate the left prevention trigger status in ITM.
    " UBYTE app_CM_boolean 0 0 0 1 ECU_ADDRESS 0x0000 /* @ECU_Address@m_ACC_is_FSMDsbl03_bl@ */ /end MEASUREMENT
/begin MEASUREMENT m_ACC_is_FSMDsbl04_bl "Indicate the left prevention trigger status in ITM.
    " UBYTE app_CM_boolean 0 0 0 1 ECU_ADDRESS 0x0000 /* @ECU_Address@m_ACC_is_FSMDsbl04_bl@ */ /end MEASUREMENT
/begin MEASUREMENT m_ACC_is_FSMDsbl05_bl "Indicate the left prevention trigger status in ITM.
    " UBYTE app_CM_boolean 0 0 0 1 ECU_ADDRESS 0x0000 /* @ECU_Address@m_ACC_is_FSMDsbl05_bl@ */ /end MEASUREMENT
/begin MEASUREMENT m_ACC_is_FSMDsbl06_bl "Indicate the left prevention trigger status in ITM.
    " UBYTE app_CM_boolean 0 0 0 1 ECU_ADDRESS 0x0000 /* @ECU_Address@m_ACC_is_FSMDsbl06_bl@ */ /end MEASUREMENT
/begin MEASUREMENT m_ACC_is_FSMDsbl07_bl "Indicate the left prevention trigger status in ITM.
    " UBYTE app_CM_boolean 0 0 0 1 ECU_ADDRESS 0x0000 /* @ECU_Address@m_ACC_is_FSMDsbl07_bl@ */ /end MEASUREMENT
/begin MEASUREMENT m_ACC_is_ACCFSMDsbl_bl "" UBYTE app_CM_boolean 0 0 0 1 ECU_ADDRESS 0x0000 /* @ECU_Address@m_ACC_is_ACCFSMDsbl_bl@ */ /end MEASUREMENT
/begin MEASUREMENT m_ACC_is_SSMDsbl01_bl "Indicate the left prevention trigger status in ITM.
    " UBYTE app_CM_boolean 0 0 0 1 ECU_ADDRESS 0x0000 /* @ECU_Address@m_ACC_is_SSMDsbl01_bl@ */ /end MEASUREMENT
/begin MEASUREMENT m_ACC_is_ACCSSMDsbl_bl "" UBYTE app_CM_boolean 0 0 0 1 ECU_ADDRESS 0x0000 /* @ECU_Address@m_ACC_is_ACCSSMDsbl_bl@ */ /end MEASUREMENT
/begin MEASUREMENT m_ACC_is_ACCReqDsbl_bl "" UBYTE app_CM_boolean 0 0 0 1 ECU_ADDRESS 0x0000 /* @ECU_Address@m_ACC_is_ACCReqDsbl_bl@ */ /end MEASUREMENT
/begin MEASUREMENT m_ACC_is_ACCReqEnbl_bl "" UBYTE app_CM_boolean 0 0 0 1 ECU_ADDRESS 0x0000 /* @ECU_Address@m_ACC_is_ACCReqEnbl_bl@ */ /end MEASUREMENT
/begin MEASUREMENT m_ACC_is_BrkOnlyEnbl_bl "" UBYTE app_CM_boolean 0 0 0 1 ECU_ADDRESS 0x0000 /* @ECU_Address@m_ACC_is_BrkOnlyEnbl_bl@ */ /end MEASUREMENT
/begin MEASUREMENT m_ACC_is_BrkOnlyExit_bl "" UBYTE app_CM_boolean 0 0 0 1 ECU_ADDRESS 0x0000 /* @ECU_Address@m_ACC_is_BrkOnlyExit_bl@ */ /end MEASUREMENT
/begin MEASUREMENT m_VehCP_is_LftStrgLmpOn_bl "" UBYTE app_CM_boolean 0 0 0 1 ECU_ADDRESS 0x0000 /* @ECU_Address@m_VehCP_is_LftStrgLmpOn_bl@ */ /end MEASUREMENT
/begin MEASUREMENT m_VehCP_is_RghtStrgLmpOn_bl "" UBYTE app_CM_boolean 0 0 0 1 ECU_ADDRESS 0x0000 /* @ECU_Address@m_VehCP_is_RghtStrgLmpOn_bl@ */ /end MEASUREMENT
/begin MEASUREMENT longt_out_isCtrlEngage "" UBYTE app_CM_boolean 0 0 0 1 ECU_ADDRESS 0x0000 /* @ECU_Address@longt_out_isCtrlEngage@ */ /end MEASUREMENT
/begin MEASUREMENT m_ACC_is_AEBActvEver_bl "" UBYTE app_CM_boolean 0 0 0 1 ECU_ADDRESS 0x0000 /* @ECU_Address@m_ACC_is_AEBActvEver_bl@ */ /end MEASUREMENT
/begin MEASUREMENT Arb_is_LatCtrlActv_bl "" UBYTE app_CM_boolean 0 0 0 1 ECU_ADDRESS 0x0000 /* @ECU_Address@Arb_is_LatCtrlActv_bl@ */ /end MEASUREMENT
/begin MEASUREMENT m_is_ACC_FaultBitlhbt_bl "Indicate the left prevention trigger status in ITM.
    " UBYTE app_CM_boolean 0 0 0 1 ECU_ADDRESS 0x0000 /* @ECU_Address@m_is_ACC_FaultBitlhbt_bl@ */ /end MEASUREMENT
/begin MEASUREMENT app_DW.tp_Stop "" UBYTE app_CM_uint8 0 0 0 255 ECU_ADDRESS 0x0000 /* @ECU_Address@app_DW.tp_Stop@ */ /end MEASUREMENT
/begin COMPU_METHOD app_CM_single "Q = V" RAT_FUNC "%8.6" "" COEFFS 0 1 0 0 0 1 /end COMPU_METHOD
/begin COMPU_METHOD app_CM_single_m "Q = V" RAT_FUNC "%8.6" "m" COEFFS 0 1 0 0 0 1 /end COMPU_METHOD
/begin COMPU_METHOD app_CM_single_m_s "Q = V" RAT_FUNC "%8.6" "m/s" COEFFS 0 1 0 0 0 1 /end COMPU_METHOD
/begin COMPU_METHOD app_CM_double "Q = V" RAT_FUNC "%15.10" "" COEFFS 0 1 0 0 0 1 /end COMPU_METHOD
/begin COMPU_METHOD app_CM_single_s "Q = V" RAT_FUNC "%8.6" "s" COEFFS 0 1 0 0 0 1 /end COMPU_METHOD
/begin COMPU_METHOD app_CM_single__ "Q = V" RAT_FUNC "%8.6" "%" COEFFS 0 1 0 0 0 1 /end COMPU_METHOD
/begin COMPU_METHOD app_CM_uint16 "Q = V" RAT_FUNC "%5.0" "" COEFFS 0 1 0 0 0 1 /end COMPU_METHOD
/begin COMPU_METHOD app_CM_boolean "Q = V" RAT_FUNC "%1.0" "" COEFFS 0 1 0 0 0 1 /end COMPU_METHOD
/begin COMPU_METHOD app_CM_uint8 "Q = V" RAT_FUNC "%3.0" "" COEFFS 0 1 0 0 0 1 /end COMPU_METHOD
/begin COMPU_METHOD app_CM_eRPL_RePlanLevel "Enumerated data type: eRPL_RePlanLevel" TAB_VERB "%0.6" "" /* Conversion Table */ COMPU_TAB_REF VTAB_FOR_app_CM_eRPL_RePlanLevel /end COMPU_METHOD
/begin COMPU_VTAB /* Name of Table */ VTAB_FOR_app_CM_eRPL_RePlanLevel "Enumerated data type: eRPL_RePlanLevel" TAB_VERB /* Number of Elements */ 5 0 "RPL_Disable" 1 "RPL_Init" 2 "RPL_RePlan" 3 "RPL_Normal" 4 "RPL_KeepTrj" /end COMPU_VTAB
/begin COMPU_METHOD app_CM_E_ACCReqSts_t "Enumerated data type: E_ACCReqSts_t" TAB_VERB "%0.6" "" /* Conversion Table */ COMPU_TAB_REF VTAB_FOR_app_CM_E_ACCReqSts_t /end COMPU_METHOD
/begin COMPU_VTAB /* Name of Table */ VTAB_FOR_app_CM_E_ACCReqSts_t "Enumerated data type: E_ACCReqSts_t" TAB_VERB /* Number of Elements */ 16 0 "eACCReqStsOff" 1 "eACCReqStsStandby" 2 "eACCReqStsActive" 3 "eACCReqStsActiveOverride" 4 "eACCReqStsBrkOnly" 5 "eStandStillActive" 6 "eStandStillWait" 7 "eCruiseCCC" 8 "eCruiseACC" 9 "eCruiseACCEmergency" 10 "eCruiseACCApproaching" 11 "eCruiseACCCurve" 12 "eACCReqStsInActive" 13 "eACCReqStsSleep" 14 "eACCRevsFault" 15 "eACCIRRevsFault" /end COMPU_VTAB
/begin GROUP app "app" /* Root */ ROOT /begin SUB_GROUP Root_Step_Func /end SUB_GROUP /end GROUP
/begin GROUP Root_Step_Func "app/Step_Func" /begin SUB_GROUP S1_Subsystem1 S1_Subsystem4 S1_main_func /end SUB_GROUP /begin REF_MEASUREMENT longt_out_drvrSetIPKSpdV longt_out_drvrSetTmDistLvl /end REF_MEASUREMENT /end GROUP
/begin GROUP S1_Subsystem1 "app/Step_Func/Subsystem1" /begin SUB_GROUP S2_Subsystem S2_Subsystem2 /end SUB_GROUP /end GROUP
/begin GROUP S1_Subsystem4 "app/Step_Func/Subsystem4" /begin SUB_GROUP S3_Ctrl S3_Subsystem S3_Subsystem2 S3_Subsystem3 S3_VIDP /end SUB_GROUP /end GROUP
/begin GROUP S1_main_func "app/Step_Func/main_func"
 /begin SUB_GROUP S4_Signal_Process_OUT S4_System_State_Machie S4_vmc_controller /end SUB_GROUP
/end GROUP
/begin GROUP S2_Subsystem "app/Step_Func/Subsystem1/Subsystem" /begin SUB_GROUP S6_CAN_Data_Decoder2 /end SUB_GROUP /end GROUP
/begin GROUP S2_Subsystem2 "app/Step_Func/Subsystem1/Subsystem2" /begin SUB_GROUP S7_Vehicle_Bus_Process /end SUB_GROUP /end GROUP
/begin GROUP S3_Ctrl "app/Step_Func/Subsystem4/Ctrl" /begin SUB_GROUP S90_Vehicle_longtAccel_Controller /end SUB_GROUP /begin REF_MEASUREMENT longt_out_desAccelCtrlCmd /end REF_MEASUREMENT /end GROUP
/begin GROUP S3_Subsystem "app/Step_Func/Subsystem4/Subsystem" /begin SUB_GROUP S92_SP /end SUB_GROUP /end GROUP
/begin GROUP S3_Subsystem2 "app/Step_Func/Subsystem4/Subsystem2"
 /begin SUB_GROUP S93_Cruise_Button_Status_Detection S93_Fault_Management S93_ODD_CC S93_SMR S93_Subsystem S93_Subsystem3 /end SUB_GROUP
 /begin REF_MEASUREMENT m_is_ACC_FaultBitlhbt_bl /end REF_MEASUREMENT
/end GROUP
/begin GROUP S3_Subsystem3 "app/Step_Func/Subsystem4/Subsystem3" /begin REF_MEASUREMENT longt_out_isCtrlEngage /end REF_MEASUREMENT /end GROUP
/begin GROUP S3_VIDP "app/Step_Func/Subsystem4/VIDP" /begin SUB_GROUP S96_AccelCal S96_EngineRunActive S96_SpdCal S96_VehRolBck /end SUB_GROUP /end GROUP
/begin GROUP S4_Signal_Process_OUT "app/Step_Func/main_func/Signal_Process_OUT" /begin SUB_GROUP S1063_FDR_HMI_Packer1 S1063_FVCM_EPS_Frame_Packer1 /end SUB_GROUP /end GROUP
/begin GROUP S4_System_State_Machie "app/Step_Func/main_func/System_State_Machie" /begin REF_MEASUREMENT Arb_is_LatCtrlActv_bl /end REF_MEASUREMENT /end GROUP
/begin GROUP S4_vmc_controller "app/Step_Func/main_func/vmc_controller" /begin SUB_GROUP S1065_Yawrate_Control1 /end SUB_GROUP /begin REF_MEASUREMENT mpc_plan_desCurve /end REF_MEASUREMENT /end GROUP
/begin GROUP S6_CAN_Data_Decoder2 "app/Step_Func/Subsystem1/Subsystem/CAN_Data_Decoder2" /begin SUB_GROUP S23_ID_492_Unpack S23_ID_516_ /end SUB_GROUP /end GROUP
/begin GROUP S7_Vehicle_Bus_Process "app/Step_Func/Subsystem1/Subsystem2/Vehicle_Bus_Process"
 /begin SUB_GROUP S75_lowpassFilter2 S75_lowpassFilter3 S75_lowpassFilter5 S75_lowpassFilter6 /end SUB_GROUP
 /begin REF_MEASUREMENT m_VehCP_is_LftStrgLmpOn_bl m_VehCP_is_RghtStrgLmpOn_bl /end REF_MEASUREMENT
/end GROUP
/begin GROUP S90_Vehicle_longtAccel_Controller "app/Step_Func/Subsystem4/Ctrl/Vehicle_longtAccel_Controller"
 /begin SUB_GROUP S102_ECM_SCS_Arbitration S102_Vehicle_LongtResist_Estimate S102_wheelForce_to_EngineTorque_Calc /end SUB_GROUP
/end GROUP
/begin GROUP S92_SP "app/Step_Func/Subsystem4/Subsystem/SP"
 /begin SUB_GROUP S137_Subsystem_LgtPrep1 S137_Subsystem_Longt_ARB S137_Subsystem_Longt_Dist1 S137_Subsystem_Longt_Spd /end SUB_GROUP
 /begin REF_CHARACTERISTIC k_TRPLon_is_Use_dst_target_bl /end REF_CHARACTERISTIC
 /begin REF_MEASUREMENT m_dst_desire m_dst_red /end REF_MEASUREMENT
/end GROUP
/begin GROUP S93_Cruise_Button_Status_Detection "app/Step_Func/Subsystem4/Subsystem2/Cruise_Button_Status_Detection" /begin SUB_GROUP S906_SwONJud /end SUB_GROUP
 /begin REF_CHARACTERISTIC P_DFIn_t_ACCSpdDecHldCmdFrq_sg P_DFIn_t_ACCSpdDecHldThrs_sg P_DFIn_t_ACCSpdIncHldCmdFrq_sg P_DFIn_t_ACCSpdIncHldThrs_sg /end REF_CHARACTERISTIC
/end GROUP
/begin GROUP S93_Fault_Management "app/Step_Func/Subsystem4/Subsystem2/Fault_Management" /begin REF_CHARACTERISTIC P_ACC_is_CCFM_FaultBitIhbtIN_bl /end REF_CHARACTERISTIC /end GROUP
/begin GROUP S93_ODD_CC "app/Step_Func/Subsystem4/Subsystem2/ODD_CC"
 /begin SUB_GROUP S908_CCFM_AM S908_CCFM_BM S908_CCFM_EM S908_CCFM_FSM S908_CCFM_OM S908_CCFM_SSM S908_Subsystem /end SUB_GROUP
/end GROUP
/begin GROUP S93_SMR "app/Step_Func/Subsystem4/Subsystem2/SMR" /begin SUB_GROUP S909_Time2Cntr_u1 S909_Time2Cntr_u16 S909_Time2Cntr_u16_ /end SUB_GROUP
 /begin REF_CHARACTERISTIC C_ACC_SMR_System_step P_ACC_V_FirstTmActvSpdThrs_sg P_ACC_V_MinCrsSpd_u8 P_ACC_is_FullGasPdlExitEnbl_bl P_ACC_is_SMRTgtLosPrtctWarnOn_bl P_ACC_perc_MinAccelPdlPos_sg P_ACC_perc_SMRAccelPdlOvrrdExit_sg P_ACC_t_AccelPdlOverrideExit_sg P_ACC_t_BrkOnlyTmThrs_sg P_ACC_t_FTCAutoGoTm_sg P_ACC_t_OvrrdExitTm_sg P_ACC_v_SMRMaxCrsSpdThrs_sg P_ACC_v_SMRMinCrsSpdThrs_u8 /end REF_CHARACTERISTIC
 /begin REF_MEASUREMENT m_FSM_sts_ACCSMRSts_en /end REF_MEASUREMENT
/end GROUP
/begin GROUP S93_Subsystem "app/Step_Func/Subsystem4/Subsystem2/Subsystem" /begin SUB_GROUP S910_DIS S910_LonHMI /end SUB_GROUP /end GROUP
/begin GROUP S93_Subsystem3 "app/Step_Func/Subsystem4/Subsystem2/Subsystem3" /begin REF_MEASUREMENT long_out_isLeadVehDtct /end REF_MEASUREMENT /end GROUP
/begin GROUP S96_AccelCal "app/Step_Func/Subsystem4/VIDP/AccelCal" /begin SUB_GROUP S1023_EstdLongtAccel1 S1023_EstdVSELongtAccel /end SUB_GROUP /end GROUP
/begin GROUP S96_EngineRunActive "app/Step_Func/Subsystem4/VIDP/EngineRunActive"
 /begin REF_CHARACTERISTIC P_ADS_is_EnASSStaConfig_bl P_ADS_is_EngTypIsMotorConfig_bl P_DFIn_n_EngRunActvMaxSpd_u16 P_DFIn_n_EngRunActvSpd_u16 /end REF_CHARACTERISTIC
/end GROUP
/begin GROUP S96_SpdCal "app/Step_Func/Subsystem4/VIDP/SpdCal" /begin SUB_GROUP S1035_EgoSpdFltr S1035_IPKSpdCal S1035_VehSpdVaild /end SUB_GROUP /end GROUP
/begin GROUP S96_VehRolBck "app/Step_Func/Subsystem4/VIDP/VehRolBck" /begin REF_CHARACTERISTIC P_DFIn_v_RolBckVehSpdThrs_sg /end REF_CHARACTERISTIC /end GROUP
/begin GROUP S1063_FDR_HMI_Packer1 "app/Step_Func/main_func/Signal_Process_OUT/FDR_HMI_Packer1" /begin REF_MEASUREMENT FVCM_HMI_Frame /end REF_MEASUREMENT /end GROUP
/begin GROUP S1063_FVCM_EPS_Frame_Packer1 "app/Step_Func/main_func/Signal_Process_OUT/FVCM_EPS_Frame_Packer1" /begin REF_MEASUREMENT FVCM_EPS_Frame /end REF_MEASUREMENT /end GROUP
/begin GROUP S1065_Yawrate_Control1 "app/Step_Func/main_func/vmc_controller/Yawrate_Control1" /begin SUB_GROUP S1141_StrgWhlAng_Limiter /end SUB_GROUP /end GROUP
/begin GROUP S23_ID_492_Unpack "app/Step_Func/Subsystem1/Subsystem/CAN_Data_Decoder2/ID_492_Unpack"
 /begin REF_MEASUREMENT m_VehCP_T_ChLKARespToq_sg m_VehCP_T_DrvrStrgDlvrdToq_sg m_VehCP_n_ChLKACtrlSts_u8 m_VehCP_n_StrgCustSetngDspCmd_u8 /end REF_MEASUREMENT
/end GROUP
/begin GROUP S23_ID_516_ "app/Step_Func/Subsystem1/Subsystem/CAN_Data_Decoder2/ID_516_" /begin REF_MEASUREMENT m_VehCP_LeftBSD_Warnning_u8 m_VehCP_RightBSD_Warnning_u8 /end REF_MEASUREMENT /end GROUP
/begin GROUP S75_lowpassFilter2 "app/Step_Func/Subsystem1/Subsystem2/Vehicle_Bus_Process/lowpassFilter2" /begin REF_MEASUREMENT m_VehCP_angD_StrgWhlAng_sg /end REF_MEASUREMENT /end GROUP
/begin GROUP S75_lowpassFilter3 "app/Step_Func/Subsystem1/Subsystem2/Vehicle_Bus_Process/lowpassFilter3" /begin REF_MEASUREMENT m_VehCP_V_VehSpdAvgDrvn_sg /end REF_MEASUREMENT /end GROUP
/begin GROUP S75_lowpassFilter5 "app/Step_Func/Subsystem1/Subsystem2/Vehicle_Bus_Process/lowpassFilter5" /begin REF_MEASUREMENT m_VehCP_yr_VehDynYawRate_sg /end REF_MEASUREMENT /end GROUP
/begin GROUP S75_lowpassFilter6 "app/Step_Func/Subsystem1/Subsystem2/Vehicle_Bus_Process/lowpassFilter6" /begin REF_MEASUREMENT m_VehCP_W_StrgWhlAngGrd_sg /end REF_MEASUREMENT /end GROUP
/begin GROUP S102_ECM_SCS_Arbitration "app/Step_Func/Subsystem4/Ctrl/Vehicle_longtAccel_Controller/ECM_SCS_Arbitration" /begin REF_CHARACTERISTIC C_ADS_M_VehMass_sg /end REF_CHARACTERISTIC /end GROUP
/begin GROUP S102_Vehicle_LongtResist_Estimate "app/Step_Func/Subsystem4/Ctrl/Vehicle_longtAccel_Controller/Vehicle_LongtResist_Estimate"
 /begin REF_CHARACTERISTIC C_ADS_A_VehAirArea_sg C_ADS_Gx_AirResistRatio_sg C_ADS_Gx_VehRollResistCmp_sg C_ADS_M_VehMass_sg C_ARB_ro_AirDensity_sg /end REF_CHARACTERISTIC
/end GROUP
/begin GROUP S102_wheelForce_to_EngineTorque_Calc "app/Step_Func/Subsystem4/Ctrl/Vehicle_longtAccel_Controller/wheelForce_to_EngineTorque_Calc" /begin SUB_GROUP S121_FuncChgRmp /end SUB_GROUP /end GROUP
/begin GROUP S137_Subsystem_LgtPrep1 "app/Step_Func/Subsystem4/Subsystem/SP/Subsystem_LgtPrep1" /begin SUB_GROUP S138_Subsystem1 S138_TVP /end SUB_GROUP /end GROUP
/begin GROUP S137_Subsystem_Longt_ARB "app/Step_Func/Subsystem4/Subsystem/SP/Subsystem_Longt_ARB" /begin SUB_GROUP S139_Subsystem /end SUB_GROUP /begin REF_CHARACTERISTIC k_TRPLon_Gx_aStateGain_sg /end REF_CHARACTERISTIC /begin REF_MEASUREMENT m_Followed_Traj /end REF_MEASUREMENT /end GROUP
/begin GROUP S137_Subsystem_Longt_Dist1 "app/Step_Func/Subsystem4/Subsystem/SP/Subsystem_Longt_Dist1" /begin SUB_GROUP S140_Longt_Dist_RePlan_Cnd S140_Opt_Coff /end SUB_GROUP /begin REF_MEASUREMENT m_TRP_Replan_Level_Dis /end REF_MEASUREMENT /end GROUP
/begin GROUP S137_Subsystem_Longt_Spd "app/Step_Func/Subsystem4/Subsystem/SP/Subsystem_Longt_Spd" /begin SUB_GROUP S141_ReplanJudge /end SUB_GROUP /begin REF_MEASUREMENT m_TRP_Replan_Level_Spd /end REF_MEASUREMENT /end GROUP
/begin GROUP S906_SwONJud "app/Step_Func/Subsystem4/Subsystem2/Cruise_Button_Status_Detection/SwONJud" /begin REF_CHARACTERISTIC P_ACC_is_VIDPConfgACCIn_bl /end REF_CHARACTERISTIC /end GROUP
/begin GROUP S908_CCFM_AM "app/Step_Func/Subsystem4/Subsystem2/ODD_CC/CCFM_AM" /begin REF_MEASUREMENT m_ACC_is_ACCActvGeneral_bl /end REF_MEASUREMENT /end GROUP
/begin GROUP S908_CCFM_BM "app/Step_Func/Subsystem4/Subsystem2/ODD_CC/CCFM_BM"
 /begin SUB_GROUP S929_BMBrkOnlyExitJud S929_BrkOnlyEnblJud S929_DFIn_is_ACCBrkOnlyExit /end SUB_GROUP
/end GROUP
/begin GROUP S908_CCFM_EM "app/Step_Func/Subsystem4/Subsystem2/ODD_CC/CCFM_EM"
 /begin REF_CHARACTERISTIC P_ACC_is_CCFM_ACCReqFltIN_bl P_ACC_is_CCFM_ACCReqIN_bl P_ACC_is_CCFM_FaultBitIhbtIN_bl P_ACC_is_CCFM_ISOCStfdIN_bl P_ACC_is_CCFM_SSOCStfdIN_bl /end REF_CHARACTERISTIC
 /begin REF_MEASUREMENT m_ACC_is_ACCReqDsbl_bl m_ACC_is_ACCReqEnbl_bl /end REF_MEASUREMENT
/end GROUP
/begin GROUP S908_CCFM_FSM "app/Step_Func/Subsystem4/Subsystem2/ODD_CC/CCFM_FSM"
 /begin SUB_GROUP S931_ACC_ISOCDsbl S931_ACC_is_ErrEnbl S931_ACC_is_VehCondEnbl S931_Bus_Selector_Subsys S931_DFIn_is_ACCDrvrSCSSet S931_DFIn_is_ACCDrvrShftPosEnbl S931_DFIn_is_DriverPresent S931_TrNonEmsnRltdMalfAJud S931_VIDPSigsDsblJud /end SUB_GROUP
/end GROUP
/begin GROUP S908_CCFM_OM "app/Step_Func/Subsystem4/Subsystem2/ODD_CC/CCFM_OM"
 /begin REF_CHARACTERISTIC P_DFIn_perc_AclActuPosOvrdHi_sg P_DFIn_perc_AclActuPosOvrdLo_sg /end REF_CHARACTERISTIC
 /begin REF_MEASUREMENT m_ACC_is_ACCOvrrdReq_bl /end REF_MEASUREMENT
/end GROUP
/begin GROUP S908_CCFM_SSM "app/Step_Func/Subsystem4/Subsystem2/ODD_CC/CCFM_SSM"
 /begin SUB_GROUP S933_ACC_SSOCJud S933_Bus_Selector_Subsys S933_SSOCActuatorJud S933_SSOCDrvrCancelJud S933_SSOCObjectJud S933_SSOCVehSpdJud /end SUB_GROUP
/end GROUP
/begin GROUP S908_Subsystem "app/Step_Func/Subsystem4/Subsystem2/ODD_CC/Subsystem" /begin REF_MEASUREMENT m_ACC_is_VehSdslSts_bl /end REF_MEASUREMENT /end GROUP
/begin GROUP S909_Time2Cntr_u1 "app/Step_Func/Subsystem4/Subsystem2/SMR/Time2Cntr_u1" /begin REF_CHARACTERISTIC C_ACC_SMR_System_step /end REF_CHARACTERISTIC /end GROUP
/begin GROUP S909_Time2Cntr_u16 "app/Step_Func/Subsystem4/Subsystem2/SMR/Time2Cntr_u16" /begin REF_CHARACTERISTIC C_ACC_SMR_System_step /end REF_CHARACTERISTIC /end GROUP
/begin GROUP S909_Time2Cntr_u16_ "app/Step_Func/Subsystem4/Subsystem2/SMR/Time2Cntr_u16_" /begin REF_CHARACTERISTIC C_ACC_SMR_System_step /end REF_CHARACTERISTIC /end GROUP
/begin GROUP S910_DIS "app/Step_Func/Subsystem4/Subsystem2/Subsystem/DIS" /begin SUB_GROUP S996_DISSpdProc S996_DISSteMag S996_DISTmDist /end SUB_GROUP /end GROUP
/begin GROUP S910_LonHMI "app/Step_Func/Subsystem4/Subsystem2/Subsystem/LonHMI" /begin SUB_GROUP S997_HMI_ACCDetObjDistLvl S997_HMI_ACCObjDetJud /end SUB_GROUP /end GROUP
/begin GROUP S1023_EstdLongtAccel1 "app/Step_Func/Subsystem4/VIDP/AccelCal/EstdLongtAccel1" /begin SUB_GROUP S1038_EstdLongtAccelCycFilt S1038_EstdLongtAccelMnFilt /end SUB_GROUP /end GROUP
/begin GROUP S1023_EstdVSELongtAccel "app/Step_Func/Subsystem4/VIDP/AccelCal/EstdVSELongtAccel"
 /begin REF_CHARACTERISTIC P_DFIn_a_EstdLogAccTrtLoThrs_sg P_DFIn_t_VSELongtAccelFilter_sg /end REF_CHARACTERISTIC
/end GROUP
/begin GROUP S1035_EgoSpdFltr "app/Step_Func/Subsystem4/VIDP/SpdCal/EgoSpdFltr" /begin REF_CHARACTERISTIC P_DFIn_cntr_VIDPEgoSpdAvgFltr_d /end REF_CHARACTERISTIC /end GROUP
/begin GROUP S1035_IPKSpdCal "app/Step_Func/Subsystem4/VIDP/SpdCal/IPKSpdCal"
 /begin REF_CHARACTERISTIC C_ADS_Gx_ActuSpdToIPKSpd_sg P_ACC_is_VIDPIPKSpdUseEstdVal_bl /end REF_CHARACTERISTIC
/end GROUP
/begin GROUP S1035_VehSpdVaild "app/Step_Func/Subsystem4/VIDP/SpdCal/VehSpdVaild" /begin REF_CHARACTERISTIC ACC_v_VIDPEgoSpdMax_sg ACC_v_VIDPEgoSpdMin_sg /end REF_CHARACTERISTIC /end GROUP
/begin GROUP S1141_StrgWhlAng_Limiter "app/Step_Func/main_func/vmc_controller/Yawrate_Control1/StrgWhlAng_Limiter" /begin REF_MEASUREMENT YRC_angD_ReqStrgWhlAng_sg /end REF_MEASUREMENT /end GROUP
/begin GROUP S121_FuncChgRmp "app/Step_Func/Subsystem4/Ctrl/Vehicle_longtAccel_Controller/wheelForce_to_EngineTorque_Calc/FuncChgRmp" /begin REF_MEASUREMENT app_DW.tp_Stop /end REF_MEASUREMENT /end GROUP
/begin GROUP S138_Subsystem1 "app/Step_Func/Subsystem4/Subsystem/SP/Subsystem_LgtPrep1/Subsystem1" /begin SUB_GROUP S147_Subsystem /end SUB_GROUP
 /begin REF_CHARACTERISTIC k_TRPLon_d_DistMinGapFar_sg k_TRPLon_d_DistMinGapMid_sg k_TRPLon_d_DistMinGapNear_sg /end REF_CHARACTERISTIC
/end GROUP
/begin GROUP S138_TVP "app/Step_Func/Subsystem4/Subsystem/SP/Subsystem_LgtPrep1/TVP"
 /begin SUB_GROUP S148_FVFP S148_FVND S148_FVSD S148_Subsystem S148_Subsystem1 /end SUB_GROUP
 /begin REF_CHARACTERISTIC k_TRPLon_is_UsedDesire0_bl k_TRPLon_is_UsedDesire1_bl /end REF_CHARACTERISTIC
/end GROUP
/begin GROUP S139_Subsystem "app/Step_Func/Subsystem4/Subsystem/SP/Subsystem_Longt_ARB/Subsystem" /begin REF_CHARACTERISTIC k_TRPLon_Gx_PrdctTime_sg k_TRPLon_is_UsePrdctTime_bl /end REF_CHARACTERISTIC /end GROUP
/begin GROUP S140_Longt_Dist_RePlan_Cnd "app/Step_Func/Subsystem4/Subsystem/SP/Subsystem_Longt_Dist1/Longt_Dist_RePlan_Cnd" /begin SUB_GROUP S238_RePlan_Cond /end SUB_GROUP /end GROUP
/begin GROUP S140_Opt_Coff "app/Step_Func/Subsystem4/Subsystem/SP/Subsystem_Longt_Dist1/Opt_Coff"
 /begin REF_CHARACTERISTIC k_TRPLon_Gx_TrajKtWght_sg k_TRPLon_cof_Kt_TblData_sg k_TRPLon_cof_TrajJerkWght_sg k_TRPLon_cof_TrajLimVlatnWght_sg /end REF_CHARACTERISTIC
/end GROUP
/begin GROUP S141_ReplanJudge "app/Step_Func/Subsystem4/Subsystem/SP/Subsystem_Longt_Spd/ReplanJudge" /begin REF_CHARACTERISTIC k_TRP_t_NrmRplnTm_sg /end REF_CHARACTERISTIC /end GROUP
/begin GROUP S929_BMBrkOnlyExitJud "app/Step_Func/Subsystem4/Subsystem2/ODD_CC/CCFM_BM/BMBrkOnlyExitJud"
 /begin REF_CHARACTERISTIC P_ACC_is_CCFM_BrkPdlBkOyIN_bl P_ACC_is_CCFM_OvrrdReqIN_bl P_ACC_is_CCFM_VehSdslIN_bl /end REF_CHARACTERISTIC
/end GROUP
/begin GROUP S929_BrkOnlyEnblJud "app/Step_Func/Subsystem4/Subsystem2/ODD_CC/CCFM_BM/BrkOnlyEnblJud" /begin REF_MEASUREMENT m_ACC_is_BrkOnlyEnbl_bl /end REF_MEASUREMENT /end GROUP
/begin GROUP S929_DFIn_is_ACCBrkOnlyExit "app/Step_Func/Subsystem4/Subsystem2/ODD_CC/CCFM_BM/DFIn_is_ACCBrkOnlyExit" /begin REF_MEASUREMENT m_ACC_is_BrkOnlyExit_bl /end REF_MEASUREMENT /end GROUP
/begin GROUP S931_ACC_ISOCDsbl "app/Step_Func/Subsystem4/Subsystem2/ODD_CC/CCFM_FSM/ACC_ISOCDsbl"
 /begin REF_MEASUREMENT m_ACC_is_ACCFSMDsbl_bl m_ACC_is_FSMDsbl01_bl m_ACC_is_FSMDsbl02_bl m_ACC_is_FSMDsbl03_bl m_ACC_is_FSMDsbl04_bl m_ACC_is_FSMDsbl05_bl m_ACC_is_FSMDsbl06_bl m_ACC_is_FSMDsbl07_bl /end REF_MEASUREMENT
/end GROUP
/begin GROUP S931_ACC_is_ErrEnbl "app/Step_Func/Subsystem4/Subsystem2/ODD_CC/CCFM_FSM/ACC_is_ErrEnbl"
 /begin REF_CHARACTERISTIC P_ACC_is_CCFM_AccRespErrIN_bl P_ACC_is_CCFM_CCSDataIngIN_bl P_ACC_is_CCFM_DspdSpdIN_bl P_ACC_is_CCFM_EPBStsUnkwIN_bl P_ACC_is_CCFM_FVCMBlkIN_bl P_ACC_is_CCFM_TCSStsFltIN_bl P_ACC_is_CCFM_ToqRespErrIN_bl P_ACC_is_CCFM_VSEStsFltIN_bl /end REF_CHARACTERISTIC
/end GROUP
/begin GROUP S931_ACC_is_VehCondEnbl "app/Step_Func/Subsystem4/Subsystem2/ODD_CC/CCFM_FSM/ACC_is_VehCondEnbl"
 /begin SUB_GROUP S941_DFIn_is_ACCECMRespEnbl S941_DFIn_is_ACCSCSRespEnbl S941_DFIn_is_AEBActvJud S941_DFIn_is_APAActv S941_DFIn_is_AirbagEnbl S941_DFIn_is_BrkDiscBrkDiscTemSts S941_DFIn_is_DrvngMdJud S941_DFIn_is_EPBStsEnbl S941_DFIn_is_TrCCCanclReq /end SUB_GROUP
/end GROUP
/begin GROUP S931_Bus_Selector_Subsys "app/Step_Func/Subsystem4/Subsystem2/ODD_CC/CCFM_FSM/Bus Selector_Subsys"
 /begin REF_MEASUREMENT m_ACC_is_ACCFSMEnbl_bl m_ACC_is_FSMEnbl01_bl m_ACC_is_FSMEnbl02_bl m_ACC_is_FSMEnbl03_bl m_ACC_is_FSMEnbl04_bl m_ACC_is_FSMEnbl05_bl m_ACC_is_FSMEnbl06_bl m_ACC_is_FSMEnbl07_bl /end REF_MEASUREMENT
/end GROUP
/begin GROUP S931_DFIn_is_ACCDrvrSCSSet "app/Step_Func/Subsystem4/Subsystem2/ODD_CC/CCFM_FSM/DFIn_is_ACCDrvrSCSSet" /begin REF_CHARACTERISTIC P_ACC_is_CCFM_TCSOpMdOffIN_bl P_ACC_is_CCFM_VSEMdOffIN_bl /end REF_CHARACTERISTIC /end GROUP
/begin GROUP S931_DFIn_is_ACCDrvrShftPosEnbl "app/Step_Func/Subsystem4/Subsystem2/ODD_CC/CCFM_FSM/DFIn_is_ACCDrvrShftPosEnbl"
 /begin REF_CHARACTERISTIC P_ACC_is_CCFM_ShftPosBtIN_bl P_ACC_is_CCFM_ShftPosNeIN_bl P_ACC_is_CCFM_ShftPosPkIN_bl P_ACC_is_CCFM_ShftPosReIN_bl P_ACC_is_CCFM_ShftPosUkIN_bl /end REF_CHARACTERISTIC
/end GROUP
/begin GROUP S931_DFIn_is_DriverPresent "app/Step_Func/Subsystem4/Subsystem2/ODD_CC/CCFM_FSM/DFIn_is_DriverPresent"
 /begin REF_CHARACTERISTIC P_ACC_is_CCFM_BntStsIN_bl P_ACC_is_CCFM_DrvDoorIN_bl P_ACC_is_CCFM_FrDoorIN_bl P_ACC_is_CCFM_LdSpcStsIN_bl P_ACC_is_CCFM_RLDoorIN_bl P_ACC_is_CCFM_RRDoorIN_bl P_ACC_is_CCFM_SafyBltStsIN_bl P_DFIn_is_CCFM_BntStsStdstlExit_bl P_DFIn_is_CCFM_FrDoorStdstlExit_bl P_DFIn_is_CCFM_LdSpcStsStdstlExit_bl P_DFIn_is_CCFM_RLDoorStdstlExit_bl P_DFIn_is_CCFM_RRDoorStdstlExit_bl P_DFIn_t_DrvrSbltAtcHys_sg /end REF_CHARACTERISTIC
 /begin REF_MEASUREMENT m_ACC_is_SafyBltFstn_bl /end REF_MEASUREMENT
/end GROUP
/begin GROUP S931_TrNonEmsnRltdMalfAJud "app/Step_Func/Subsystem4/Subsystem2/ODD_CC/CCFM_FSM/TrNonEmsnRltdMalfAJud" /begin REF_CHARACTERISTIC P_ACC_is_CCFM_EmsnRltdIN_bl P_ACC_is_CCFM_NonEmsnRltdIN_bl /end REF_CHARACTERISTIC /end GROUP
/begin GROUP S931_VIDPSigsDsblJud "app/Step_Func/Subsystem4/Subsystem2/ODD_CC/CCFM_FSM/VIDPSigsDsblJud" /begin REF_CHARACTERISTIC P_ACC_is_CCFM_EnNoActvIN_bl P_ACC_is_CCFM_RolBckIN_bl /end REF_CHARACTERISTIC /end GROUP
/begin GROUP S933_ACC_SSOCJud "app/Step_Func/Subsystem4/Subsystem2/ODD_CC/CCFM_SSM/ACC_SSOCJud" /begin REF_MEASUREMENT m_ACC_is_ACCSSMDsbl_bl m_ACC_is_SSMDsbl01_bl /end REF_MEASUREMENT /end GROUP
/begin GROUP S933_Bus_Selector_Subsys "app/Step_Func/Subsystem4/Subsystem2/ODD_CC/CCFM_SSM/Bus Selector_Subsys" /begin REF_MEASUREMENT m_ACC_is_ACCSSMEnbl_bl m_ACC_is_SSMEnbl01_bl /end REF_MEASUREMENT /end GROUP
/begin GROUP S933_SSOCActuatorJud "app/Step_Func/Subsystem4/Subsystem2/ODD_CC/CCFM_SSM/SSOCActuatorJud"
 /begin REF_CHARACTERISTIC P_ACC_is_CCFM_ABSActvEnIN_bl P_ACC_is_CCFM_ABSActvIN_bl P_ACC_is_CCFM_HDCActvEnIN_bl P_ACC_is_CCFM_HDCActvIN_bl P_ACC_is_CCFM_MSRActvEnIN_bl P_ACC_is_CCFM_MSRActvIN_bl P_ACC_is_CCFM_TCSActvEnIN_bl P_ACC_is_CCFM_TCSActvIN_bl P_ACC_is_CCFM_VSEActvEnIN_bl P_ACC_is_CCFM_VSEActvIN_bl P_DFIn_t_ABSActv_sg P_DFIn_t_ESPActv_sg P_DFIn_t_HDCActv_sg P_DFIn_t_TCSActv_sg /end REF_CHARACTERISTIC
/end GROUP
/begin GROUP S933_SSOCDrvrCancelJud "app/Step_Func/Subsystem4/Subsystem2/ODD_CC/CCFM_SSM/SSOCDrvrCancelJud" /begin REF_CHARACTERISTIC P_ACC_is_CCFM_ACCCanclIN_bl /end REF_CHARACTERISTIC /end GROUP
/begin GROUP S933_SSOCObjectJud "app/Step_Func/Subsystem4/Subsystem2/ODD_CC/CCFM_SSM/SSOCObjectJud" /begin REF_CHARACTERISTIC P_ACC_is_CCFM_ACCTgtLosIN_bl /end REF_CHARACTERISTIC /end GROUP
/begin GROUP S933_SSOCVehSpdJud "app/Step_Func/Subsystem4/Subsystem2/ODD_CC/CCFM_SSM/SSOCVehSpdJud" /begin REF_CHARACTERISTIC P_ACC_V_MaxACCActvSpd_u8 P_ACC_is_CCFM_VehSpdOvrIN_bl /end REF_CHARACTERISTIC /end GROUP
/begin GROUP S996_DISSpdProc "app/Step_Func/Subsystem4/Subsystem2/Subsystem/DIS/DISSpdProc"
 /begin REF_CHARACTERISTIC C_ACC_Gx_HMIActuSpdToIPKSpd_sg C_ACC_HMIZero_sg P_ACC_V_HMIMemSpdHiThrs_sg P_ACC_V_HMIMemSpdLoThrs_sg P_ACC_v_HMISetSpdHiThrs_sg P_ACC_v_HMISetSpdLoThrs_sg P_TY_ACC_V_HMIDISSetSpdCmpCnst_sg /end REF_CHARACTERISTIC
/end GROUP
/begin GROUP S996_DISSteMag "app/Step_Func/Subsystem4/Subsystem2/Subsystem/DIS/DISSteMag"
 /begin REF_CHARACTERISTIC C_ACC_HMISwitch_Off_bl C_ACC_HMISwitch_On_bl P_ACC_V_HMIMinCrsSetSpd_u8 P_ACC_V_HMISETBtnDecMax_u8 P_ACC_cntr_HMISETBtnDecFunc_u16 P_ACC_indx_HMIDISSpdSwChgRng_u8 P_ACC_is_HMIDISMemSpdChgEnBrkO_bl P_ACC_is_HMIDISMemSpdChgEnSdby_bl P_ACC_is_HMIDISMemSpdChgEnStslW_bl P_ACC_is_HMIDISSetSpdChgEnOvrd_bl P_ACC_is_HMIDISSetSpdChgEnStslA_bl P_ACC_is_HMIDISSetSpdSetEnOvrd_bl P_ACC_is_HMIDISSetSpdSetEnStslA_bl P_ACC_is_HMIRSMActvFstStdByConfig_bl P_ACC_is_HMIResumeIncSpdConfig_bl P_ACC_is_HMISETDecSpdConfig_bl P_ACC_is_HMITJAMaxSpdConfigOpn_bl P_ACC_perc_HMIGoGasPdlThrs_sg P_ACC_v_HMIMaxCrsSpdThrsLatActv_sg P_ACC_v_HMIMaxCrsSpdThrs_sg P_ACC_v_HMIMinCrsSpdThrs_u8 /end REF_CHARACTERISTIC
/end GROUP
/begin GROUP S996_DISTmDist "app/Step_Func/Subsystem4/Subsystem2/Subsystem/DIS/DISTmDist"
 /begin REF_CHARACTERISTIC C_ACC_HMISwitch_On_bl C_ACC_HMIZero_bl P_ACC_indx_HMIIniCruzTmDist_u8 /end REF_CHARACTERISTIC
/end GROUP
/begin GROUP S997_HMI_ACCDetObjDistLvl "app/Step_Func/Subsystem4/Subsystem2/Subsystem/LonHMI/HMI_ACCDetObjDistLvl"
 /begin REF_CHARACTERISTIC P_ACC_Gx_HMIDistLvlLgrCmpCoe_sg P_ACC_Gx_HMIDistLvlSmlCmpCoe_sg P_ACC_Gx_HMIDsrdDistLvl1Mid_sg P_ACC_Gx_HMIDsrdDistLvl1Ner_sg P_ACC_d_HMIDistLvlLgrCmp_sg P_ACC_d_HMIDistLvlSmlCmp_sg P_TY_ACC_d_HMIDetDistLvl12Cmp_sg P_TY_ACC_d_HMIDetDistLvl23Cmp_sg /end REF_CHARACTERISTIC
/end GROUP
/begin GROUP S997_HMI_ACCObjDetJud "app/Step_Func/Subsystem4/Subsystem2/Subsystem/LonHMI/HMI_ACCObjDetJud"
 /begin REF_CHARACTERISTIC C_ACC_HMIZero_bl P_ACC_d_HMIObjDetMovObjDist_sg P_ACC_d_HMIObjDetStnObjDist_sg P_ACC_t_HMIObjDetMovObjTmCfm_sg P_ACC_t_HMIObjDetStnObjTmCfm_sg P_ACC_v_HMIObjDetMovObjSpd_sg P_ACC_v_HMIObjDetStnObjSpd_sg /end REF_CHARACTERISTIC
/end GROUP
/begin GROUP S1038_EstdLongtAccelCycFilt "app/Step_Func/Subsystem4/VIDP/AccelCal/EstdLongtAccel1/EstdLongtAccelCycFilt" /begin REF_CHARACTERISTIC C_DFIn_t_AccelDelyFilt_sg /end REF_CHARACTERISTIC /end GROUP
/begin GROUP S1038_EstdLongtAccelMnFilt "app/Step_Func/Subsystem4/VIDP/AccelCal/EstdLongtAccel1/EstdLongtAccelMnFilt" /begin REF_CHARACTERISTIC P_DFIn_cntr_DelayCntr_d /end REF_CHARACTERISTIC /end GROUP
/begin GROUP S147_Subsystem "app/Step_Func/Subsystem4/Subsystem/SP/Subsystem_LgtPrep1/Subsystem1/Subsystem"
 /begin REF_CHARACTERISTIC k_TRPLon_TY_t_FTCDsrdDistLv1_sg k_TRPLon_TY_t_FTCDsrdDistLv2_sg k_TRPLon_TY_t_FTCDsrdDistLv3_sg k_TRPLon_TY_t_FTCdDesDistLv1_sg k_TRPLon_TY_t_FTCdDesDistLv2_sg k_TRPLon_TY_t_FTCdDesDistLv3_sg k_TRPLon_is_FTCBMDsrdDistMdOn_bl /end REF_CHARACTERISTIC
/end GROUP
/begin GROUP S148_FVFP "app/Step_Func/Subsystem4/Subsystem/SP/Subsystem_LgtPrep1/TVP/FVFP" /begin REF_MEASUREMENT m_dst_target /end REF_MEASUREMENT /end GROUP
/begin GROUP S148_FVND "app/Step_Func/Subsystem4/Subsystem/SP/Subsystem_LgtPrep1/TVP/FVND" /begin SUB_GROUP S182_dDesire_base /end SUB_GROUP /end GROUP
/begin GROUP S148_FVSD "app/Step_Func/Subsystem4/Subsystem/SP/Subsystem_LgtPrep1/TVP/FVSD" /begin SUB_GROUP S183_dSafeGap_base /end SUB_GROUP /end GROUP
/begin GROUP S148_Subsystem "app/Step_Func/Subsystem4/Subsystem/SP/Subsystem_LgtPrep1/TVP/Subsystem" /begin REF_CHARACTERISTIC k_TRPLon_a_ComfortBrake_sg /end REF_CHARACTERISTIC /end GROUP
/begin GROUP S148_Subsystem1 "app/Step_Func/Subsystem4/Subsystem/SP/Subsystem_LgtPrep1/TVP/Subsystem1" /begin REF_CHARACTERISTIC k_TRPLon_t_RelDistPrdctTmVx_sg /end REF_CHARACTERISTIC /end GROUP
/begin GROUP S238_RePlan_Cond "app/Step_Func/Subsystem4/Subsystem/SP/Subsystem_Longt_Dist1/Longt_Dist_RePlan_Cnd/RePlan_Cond" /begin REF_CHARACTERISTIC k_TRPLon_t_DistNrmRePlanTm_sg /end REF_CHARACTERISTIC /end GROUP
/begin GROUP S941_DFIn_is_ACCECMRespEnbl "app/Step_Func/Subsystem4/Subsystem2/ODD_CC/CCFM_FSM/ACC_is_VehCondEnbl/DFIn_is_ACCECMRespEnbl"
 /begin REF_CHARACTERISTIC P_ACC_is_CCFM_ToqRepLArbEnIN_bl P_ACC_is_CCFM_ToqRepPCndEnIN_bl P_ACC_is_CCFM_ToqRespLArbIN_bl P_ACC_is_CCFM_ToqRespNReqIN_bl P_ACC_is_CCFM_ToqRespPCndIN_bl P_DFIn_t_ACCToqReqRespNoReqHys_sg /end REF_CHARACTERISTIC
/end GROUP
/begin GROUP S941_DFIn_is_ACCSCSRespEnbl "app/Step_Func/Subsystem4/Subsystem2/ODD_CC/CCFM_FSM/ACC_is_VehCondEnbl/DFIn_is_ACCSCSRespEnbl"
 /begin REF_CHARACTERISTIC P_ACC_is_CCFM_AccRepLArbEnIN_bl P_ACC_is_CCFM_AccRepPCndEnIN_bl P_ACC_is_CCFM_AccRespLArbIN_bl P_ACC_is_CCFM_AccRespNReqIN_bl P_ACC_is_CCFM_AccRespPCndIN_bl P_DFIn_t_ChACCAccReqRespLosArb_sg P_DFIn_t_ChACCAccReqRespNoReqHys_sg /end REF_CHARACTERISTIC
/end GROUP
/begin GROUP S941_DFIn_is_AEBActvJud "app/Step_Func/Subsystem4/Subsystem2/ODD_CC/CCFM_FSM/ACC_is_VehCondEnbl/DFIn_is_AEBActvJud"
 /begin REF_CHARACTERISTIC P_ACC_is_CCFM_AEBPActvIN_bl P_ACC_is_CCFM_AEBVActvExitIN_bl P_ACC_is_CCFM_AEBVActvIN_bl P_DFIn_t_CCFMAEBActvEver_sg /end REF_CHARACTERISTIC
 /begin REF_MEASUREMENT m_ACC_is_AEBActvEver_bl /end REF_MEASUREMENT
/end GROUP
/begin GROUP S941_DFIn_is_APAActv "app/Step_Func/Subsystem4/Subsystem2/ODD_CC/CCFM_FSM/ACC_is_VehCondEnbl/DFIn_is_APAActv" /begin REF_CHARACTERISTIC P_ACC_is_CCFM_APAActvIN_bl P_ACC_is_CCFM_NRCDActvIN_bl /end REF_CHARACTERISTIC /end GROUP
/begin GROUP S941_DFIn_is_AirbagEnbl "app/Step_Func/Subsystem4/Subsystem2/ODD_CC/CCFM_FSM/ACC_is_VehCondEnbl/DFIn_is_AirbagEnbl" /begin REF_CHARACTERISTIC P_ACC_is_CCFM_AirbagStsIN_bl /end REF_CHARACTERISTIC /end GROUP
/begin GROUP S941_DFIn_is_BrkDiscBrkDiscTemSts "app/Step_Func/Subsystem4/Subsystem2/ODD_CC/CCFM_FSM/ACC_is_VehCondEnbl/DFIn_is_BrkDiscBrkDiscTemSts" /begin REF_CHARACTERISTIC P_ACC_is_CCFM_BrkDicTemHIN_bl /end REF_CHARACTERISTIC /end GROUP
/begin GROUP S941_DFIn_is_DrvngMdJud "app/Step_Func/Subsystem4/Subsystem2/ODD_CC/CCFM_FSM/ACC_is_VehCondEnbl/DFIn_is_DrvngMdJud" /begin REF_CHARACTERISTIC P_ACC_is_CCFM_DrvngMdNoSuptIN_bl /end REF_CHARACTERISTIC /end GROUP
/begin GROUP S941_DFIn_is_EPBStsEnbl "app/Step_Func/Subsystem4/Subsystem2/ODD_CC/CCFM_FSM/ACC_is_VehCondEnbl/DFIn_is_EPBStsEnbl" /begin REF_CHARACTERISTIC P_ACC_is_CCFM_EPBAppIN_bl P_ACC_is_CCFM_EPBCCCanclIN_bl /end REF_CHARACTERISTIC /end GROUP
/begin GROUP S941_DFIn_is_TrCCCanclReq "app/Step_Func/Subsystem4/Subsystem2/ODD_CC/CCFM_FSM/ACC_is_VehCondEnbl/DFIn_is_TrCCCanclReq" /begin REF_CHARACTERISTIC P_ACC_is_CCFM_TrCCCanclIN_bl /end REF_CHARACTERISTIC /end GROUP
/begin GROUP S182_dDesire_base "app/Step_Func/Subsystem4/Subsystem/SP/Subsystem_LgtPrep1/TVP/FVND/dDesire_base"
 /begin REF_CHARACTERISTIC k_TRPLon_Gx_DesireDistHiSpd_sg k_TRPLon_Gx_DesireDistLowSpd_sg /end REF_CHARACTERISTIC
/end GROUP
/begin GROUP S183_dSafeGap_base "app/Step_Func/Subsystem4/Subsystem/SP/Subsystem_LgtPrep1/TVP/FVSD/dSafeGap_base"
 /begin REF_CHARACTERISTIC k_TRPLon_Gx_DesireDistHiSpd_sg k_TRPLon_Gx_DesireDistLowSpd_sg /end REF_CHARACTERISTIC
/end GROUP
/end MODULE
/end PROJECT
/* (add any file trailer comments here) */
/* EOF app.a2l */
